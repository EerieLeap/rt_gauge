## CMakeLists.txt
```
cmake_minimum_required(VERSION 3.20.0)

set(RT_GAUGE_TEST_SIM_FLASH ON)
set(RT_GAUGE_TEST_LVGL ON)
include(${CMAKE_CURRENT_SOURCE_DIR}/../../rt_gauge_test.cmake)

# Use Zephyr's build system
find_package(Zephyr REQUIRED HINTS $ENV{ZEPHYR_BASE})
project(unit_domain)

include_directories(${APP_SRC_DIR})
include_directories(${RT_GAUGE_DIR}/tests/common)

set(APP_SRC_CONFIGURATION_DIR ${APP_SRC_DIR}/configuration)
file(GLOB_RECURSE APP_SRC_CONFIGURATION
  ${APP_SRC_CONFIGURATION_DIR}/*.c
  ${APP_SRC_CONFIGURATION_DIR}/*.cpp
)

set(APP_SRC_UI_DOMAIN_DIR ${APP_SRC_DIR}/domain/ui_domain)
file(GLOB_RECURSE APP_SRC_UI_DOMAIN
  ${APP_SRC_UI_DOMAIN_DIR}/models/*.cpp
  ${APP_SRC_UI_DOMAIN_DIR}/configuration/parsers/*.cpp
  ${APP_SRC_UI_DOMAIN_DIR}/preview/*.cpp
)

file(GLOB_RECURSE TEST_SOURCES src/*.c src/*.cpp)

# Add all source files to the app target
target_sources(app PRIVATE
  ${APP_SRC_CONFIGURATION}
  ${APP_SRC_UI_DOMAIN}
  ${APP_SRC_DIR}/domain/display_domain/configuration/parsers/display_configuration_cbor_parser.cpp
  ${APP_SRC_DIR}/views/utilitites/grid_layout.cpp
  ${TEST_SOURCES}
)
```

## prj.conf
```kconfig
CONFIG_ZTEST=y

#HW Version
CONFIG_EERIE_LEAP_HW_VERSION_MAJOR=2
CONFIG_EERIE_LEAP_HW_VERSION_MINOR=9
CONFIG_EERIE_LEAP_HW_VERSION_PATCH=6

#SW Version
CONFIG_EERIE_LEAP_SW_VERSION_MAJOR=7
CONFIG_EERIE_LEAP_SW_VERSION_MINOR=8
CONFIG_EERIE_LEAP_SW_VERSION_PATCH=4

# Language and Compiler
CONFIG_CPP=y
CONFIG_PICOLIBC=y
CONFIG_STD_CPP23=y
CONFIG_REQUIRES_FULL_LIBCPP=y
CONFIG_CPP_EXCEPTIONS=y
CONFIG_CPP_RTTI=y

# Memory
CONFIG_HEAP_MEM_POOL_SIZE=32768

# C++ exception unwinding needs considerably more stack than the ztest defaults. The validator tests that throw
# take up to 12116 bytes of the test thread's stack on qemu_riscv64 (this plus TEST_EXTRA_STACK_SIZE).
CONFIG_MAIN_STACK_SIZE=8192
CONFIG_ZTEST_STACK_SIZE=16384

# Logging And Debugging
CONFIG_LOG=y
CONFIG_TEST_RANDOM_GENERATOR=y
CONFIG_THREAD_ANALYZER=y
CONFIG_THREAD_ANALYZER_USE_LOG=y
CONFIG_THREAD_RUNTIME_STATS=y
CONFIG_THREAD_NAME=y
CONFIG_SYS_HEAP_RUNTIME_STATS=y
CONFIG_THREAD_ANALYZER_ISR_STACK_USAGE=n

# FS Config
CONFIG_FLASH=y
CONFIG_FLASH_MAP=y
CONFIG_FILE_SYSTEM=y
CONFIG_FILE_SYSTEM_LITTLEFS=y
CONFIG_FILE_SYSTEM_MKFS=y

# CBOR
CONFIG_ZCBOR=y

# LVGL
CONFIG_LVGL=y
CONFIG_LV_Z_MEM_POOL_SIZE=32768

CONFIG_CRC=y
CONFIG_TIMING_FUNCTIONS=y

CONFIG_EERIE_LEAP_RT_CORE=y
CONFIG_EERIE_LEAP_CONFIGURATION=y
CONFIG_EERIE_LEAP_DEVICE_TREE=y
CONFIG_EERIE_LEAP_FS=y
CONFIG_EERIE_LEAP_RANDOM=y
CONFIG_EERIE_LEAP_TIME=y
CONFIG_EERIE_LEAP_LUA_SCRIPT=y
CONFIG_EERIE_LEAP_EXPRESSION_ENGINE=y
```

## src/display_configuration_cbor_parser.cpp
```c
#include <cstdint>
#include <stdexcept>
#include <string>
#include <utility>

#include <zephyr/ztest.h>

#include "utilities/memory/memory_resource_manager.h"

#include "configuration/cbor/cbor_display_config/cbor_display_config.h"
#include "domain/display_domain/configuration/parsers/display_configuration_cbor_parser.h"
#include "domain/display_domain/models/display_configuration.h"

using eerie_leap::domain::display_domain::configuration::parsers::DisplayConfigurationCborParser;
using eerie_leap::domain::display_domain::models::DisplayConfiguration;
using eerie_leap::utilities::memory::Mrm;

namespace {

template<typename Fn>
std::string ThrownMessage(Fn&& fn) {
    try {
        std::forward<Fn>(fn)();
    } catch(const std::exception& e) {
        return e.what();
    } catch(...) {
        return "unexpected exception";
    }

    return "no exception";
}

CborDisplayConfig MakeCborConfig() {
    return CborDisplayConfig{ .version = DisplayConfigurationCborParser::CONFIGURATION_VERSION,
        .brightness = 200,
        .blanking_enabled = true,
        .screen_timeout_s = 45,
        .theme_id = 3 };
}

} // namespace

ZTEST_SUITE(display_configuration_cbor_parser, NULL, NULL, NULL, NULL, NULL);

ZTEST(display_configuration_cbor_parser, test_defaults_leave_the_panel_lit) {
    DisplayConfiguration configuration;

    zassert_equal(configuration.brightness, 160);
    zassert_false(configuration.blanking_enabled);
    zassert_equal(configuration.screen_timeout_s, 0);
    zassert_equal(configuration.theme_id, 0);
}

ZTEST(display_configuration_cbor_parser, test_serialize_stamps_the_current_version) {
    DisplayConfiguration configuration;
    configuration.brightness = 12;

    auto config = DisplayConfigurationCborParser::Serialize(configuration);

    zassert_equal(config->version, DisplayConfigurationCborParser::CONFIGURATION_VERSION);
    zassert_equal(config->brightness, 12);
}

ZTEST(display_configuration_cbor_parser, test_round_trip_preserves_every_field) {
    DisplayConfiguration configuration;
    configuration.brightness = 77;
    configuration.blanking_enabled = true;
    configuration.screen_timeout_s = 30;
    configuration.theme_id = 2;

    auto config = DisplayConfigurationCborParser::Serialize(configuration);
    auto restored = DisplayConfigurationCborParser::Deserialize(Mrm::GetDefaultPmr(), *config);

    zassert_equal(restored->brightness, 77);
    zassert_true(restored->blanking_enabled);
    zassert_equal(restored->screen_timeout_s, 30);
    zassert_equal(restored->theme_id, 2);
}

ZTEST(display_configuration_cbor_parser, test_deserialize_accepts_the_current_version) {
    auto config = MakeCborConfig();
    auto restored = DisplayConfigurationCborParser::Deserialize(Mrm::GetDefaultPmr(), config);

    zassert_equal(restored->brightness, 200);
    zassert_true(restored->blanking_enabled);
    zassert_equal(restored->screen_timeout_s, 45);
    zassert_equal(restored->theme_id, 3);
}

// A stored config written by another layout must fail loudly so the manager
// regenerates defaults instead of reading field-shifted values.
ZTEST(display_configuration_cbor_parser, test_deserialize_rejects_another_version) {
    auto config = MakeCborConfig();
    config.version = DisplayConfigurationCborParser::CONFIGURATION_VERSION + 1;

    auto message = ThrownMessage([&] {
        DisplayConfigurationCborParser::Deserialize(Mrm::GetDefaultPmr(), config);
    });

    zassert_equal(
        message,
        "Invalid Display configuration. Unsupported version: "
            + std::to_string(DisplayConfigurationCborParser::CONFIGURATION_VERSION + 1)
            + ". Expected: " + std::to_string(DisplayConfigurationCborParser::CONFIGURATION_VERSION) + ".",
        "%s", message.c_str()
    );
}

// The schema stores brightness as a uint; the model is a uint8_t.
ZTEST(display_configuration_cbor_parser, test_deserialize_rejects_out_of_range_brightness) {
    auto config = MakeCborConfig();
    config.brightness = 256;

    auto message = ThrownMessage([&] {
        DisplayConfigurationCborParser::Deserialize(Mrm::GetDefaultPmr(), config);
    });

    zassert_equal(
        message, "Invalid Display configuration. Brightness must be between 0 and 255. Value: 256.", "%s",
        message.c_str()
    );
}

ZTEST(display_configuration_cbor_parser, test_deserialize_accepts_the_brightness_bounds) {
    auto config = MakeCborConfig();
    config.brightness = 255;
    zassert_equal(DisplayConfigurationCborParser::Deserialize(Mrm::GetDefaultPmr(), config)->brightness, 255);

    config.brightness = 0;
    zassert_equal(DisplayConfigurationCborParser::Deserialize(Mrm::GetDefaultPmr(), config)->brightness, 0);
}
```

## src/grid_layout.cpp
```c
#include <cstdint>
#include <stdexcept>
#include <string>
#include <utility>

#include <zephyr/ztest.h>

#include "domain/ui_domain/models/grid_settings.h"
#include "domain/ui_domain/models/widget_position.h"
#include "domain/ui_domain/models/widget_size.h"
#include "views/utilitites/grid_layout.h"

using eerie_leap::domain::ui_domain::models::GridSettings;
using eerie_leap::domain::ui_domain::models::WidgetPosition;
using eerie_leap::domain::ui_domain::models::WidgetSize;
using eerie_leap::views::utilitites::GridLayout;

namespace {

constexpr int32_t SCREEN_SIZE = 400;

GridSettings MakeGrid(uint32_t width, uint32_t height, uint32_t spacing_px) {
    return GridSettings{ .snap_enabled = false, .width = width, .height = height, .spacing_px = spacing_px };
}

// GridLayout::FromActiveScreen() needs a bound display, so the tests build the
// layout against a fixed screen size instead.
GridLayout MakeLayout(uint32_t grid_width, uint32_t grid_height, uint32_t spacing_px) {
    return { MakeGrid(grid_width, grid_height, spacing_px), SCREEN_SIZE, SCREEN_SIZE };
}

std::string InvalidArgumentMessage(const GridSettings& grid, int32_t screen_width, int32_t screen_height) {
    try {
        GridLayout layout(grid, screen_width, screen_height);
    } catch(const std::invalid_argument& e) {
        return e.what();
    } catch(...) {
        return "unexpected exception";
    }

    return "no exception";
}

template<typename Fn>
std::string ThrownMessage(Fn&& fn) {
    try {
        std::forward<Fn>(fn)();
    } catch(const std::exception& e) {
        return e.what();
    } catch(...) {
        return "unexpected exception";
    }

    return "no exception";
}

} // namespace

ZTEST_SUITE(grid_layout, NULL, NULL, NULL, NULL, NULL);

ZTEST(grid_layout, test_a_widget_spanning_the_whole_grid_fills_the_screen) {
    auto layout = MakeLayout(4, 4, 5);

    auto size_px = layout.ToPx(WidgetSize{ .width = 4, .height = 4 });

    // The full-span shortcut ignores the spacing so the widget reaches the edges.
    zassert_equal(size_px.width, static_cast<uint32_t>(SCREEN_SIZE));
    zassert_equal(size_px.height, static_cast<uint32_t>(SCREEN_SIZE));
}

ZTEST(grid_layout, test_a_cell_sized_widget_is_one_grid_step_without_spacing) {
    auto layout = MakeLayout(4, 4, 0);

    auto size_px = layout.ToPx(WidgetSize{ .width = 1, .height = 1 });

    zassert_equal(size_px.width, 100U);
    zassert_equal(size_px.height, 100U);
}

ZTEST(grid_layout, test_the_spacing_is_removed_from_both_edges_of_a_widget) {
    auto layout = MakeLayout(4, 4, 5);

    auto size_px = layout.ToPx(WidgetSize{ .width = 1, .height = 1 });

    // 400 / 4 - 5 * 2
    zassert_equal(size_px.width, 90U);
    zassert_equal(size_px.height, 90U);
}

ZTEST(grid_layout, test_a_widget_scales_with_the_number_of_cells_it_spans) {
    auto layout = MakeLayout(4, 4, 0);

    auto size_px = layout.ToPx(WidgetSize{ .width = 2, .height = 3 });

    zassert_equal(size_px.width, 200U);
    zassert_equal(size_px.height, 300U);
}

ZTEST(grid_layout, test_each_axis_uses_its_own_grid_extent) {
    GridLayout layout(MakeGrid(2, 8, 0), SCREEN_SIZE, SCREEN_SIZE);

    auto size_px = layout.ToPx(WidgetSize{ .width = 1, .height = 1 });

    zassert_equal(size_px.width, 200U);
    zassert_equal(size_px.height, 50U);
}

ZTEST(grid_layout, test_the_origin_sits_at_the_bottom_left_of_the_screen) {
    auto layout = MakeLayout(4, 4, 0);
    WidgetSize size_px{ .width = 100, .height = 100 };

    auto position_px = layout.ToPx(WidgetPosition{ .x = 0, .y = 0 }, size_px);

    // Grid y counts up from the bottom, pixel y counts down from the top.
    zassert_equal(position_px.x, 0);
    zassert_equal(position_px.y, 300);
}

ZTEST(grid_layout, test_the_top_row_lands_flush_with_the_top_edge) {
    auto layout = MakeLayout(4, 4, 0);
    WidgetSize size_px{ .width = 100, .height = 100 };

    auto position_px = layout.ToPx(WidgetPosition{ .x = 1, .y = 3 }, size_px);

    zassert_equal(position_px.x, 100);
    zassert_equal(position_px.y, 0);
}

ZTEST(grid_layout, test_a_position_advances_by_whole_cells) {
    auto layout = MakeLayout(4, 4, 0);
    WidgetSize size_px{ .width = 100, .height = 100 };

    auto position_px = layout.ToPx(WidgetPosition{ .x = 3, .y = 1 }, size_px);

    zassert_equal(position_px.x, 300);
    zassert_equal(position_px.y, 200);
}

ZTEST(grid_layout, test_the_spacing_widens_the_cell_step_of_a_position) {
    auto layout = MakeLayout(4, 4, 5);
    WidgetSize size_px{ .width = 90, .height = 90 };

    // Cell step is 400 / 4 + 5 * 2.
    auto position_px = layout.ToPx(WidgetPosition{ .x = 2, .y = 2 }, size_px);

    zassert_equal(position_px.x, 220);
    zassert_equal(position_px.y, 90);
}

ZTEST(grid_layout, test_a_grid_wider_than_the_screen_is_rejected) {
    zassert_equal(
        InvalidArgumentMessage(MakeGrid(SCREEN_SIZE + 1, 4, 0), SCREEN_SIZE, SCREEN_SIZE),
        std::string("Invalid screen width.")
    );
}

ZTEST(grid_layout, test_a_grid_taller_than_the_screen_is_rejected) {
    zassert_equal(
        InvalidArgumentMessage(MakeGrid(4, SCREEN_SIZE + 1, 0), SCREEN_SIZE, SCREEN_SIZE),
        std::string("Invalid screen height.")
    );
}

ZTEST(grid_layout, test_an_empty_grid_axis_is_rejected) {
    zassert_equal(
        InvalidArgumentMessage(MakeGrid(0, 4, 0), SCREEN_SIZE, SCREEN_SIZE), std::string("Invalid screen width.")
    );

    zassert_equal(
        InvalidArgumentMessage(MakeGrid(4, 0, 0), SCREEN_SIZE, SCREEN_SIZE), std::string("Invalid screen height.")
    );
}

ZTEST(grid_layout, test_an_unsized_screen_is_rejected) {
    zassert_equal(
        InvalidArgumentMessage(MakeGrid(4, 4, 0), 0, SCREEN_SIZE), std::string("Invalid active screen size.")
    );

    zassert_equal(
        InvalidArgumentMessage(MakeGrid(4, 4, 0), SCREEN_SIZE, -1), std::string("Invalid active screen size.")
    );
}

ZTEST(grid_layout, test_a_widget_without_an_extent_is_rejected) {
    auto layout = MakeLayout(4, 4, 0);

    zassert_equal(
        ThrownMessage([&layout] {
            (void)layout.ToPx(WidgetSize{ .width = 0, .height = 1 });
        }),
        std::string("Invalid widget width.")
    );

    zassert_equal(
        ThrownMessage([&layout] {
            (void)layout.ToPx(WidgetSize{ .width = 1, .height = 0 });
        }),
        std::string("Invalid widget height.")
    );
}

ZTEST(grid_layout, test_positioning_a_widget_of_unknown_size_is_rejected) {
    auto layout = MakeLayout(4, 4, 0);
    WidgetPosition position_grid{ .x = 0, .y = 0 };

    zassert_equal(
        ThrownMessage([&layout, &position_grid] {
            (void)layout.ToPx(position_grid, WidgetSize{ .width = 0, .height = 0 });
        }),
        std::string("Widget size is not set.")
    );
}
```

## src/ui_configuration_binding_bytes.cpp
```c
#include <algorithm>
#include <cstdint>
#include <cstring>
#include <iterator>
#include <memory_resource>
#include <span>
#include <stdexcept>
#include <string>
#include <utility>
#include <variant>
#include <vector>

#include <eerie_memory.hpp>
#include <zephyr/kernel.h>
#include <zephyr/ztest.h>

#include "configuration/cbor/cbor_serializer.h"
#include "configuration/cbor/cbor_ui_config/cbor_ui_config.h"
#include "utilities/memory/memory_resource_manager.h"

#include "domain/logging_domain/event_bus/logging_event_type.h"
#include "domain/logging_domain/event_bus/logging_payload_type.h"
#include "domain/sensor_domain/event_bus/sensor_event_type.h"
#include "domain/sensor_domain/event_bus/sensor_payload_type.h"
#include "domain/settings_domain/event_bus/settings_event_type.h"
#include "domain/settings_domain/event_bus/settings_payload_type.h"
#include "domain/ui_domain/event_bus/navigation_event_type.h"
#include "domain/ui_domain/event_bus/navigation_payload_type.h"

#include "domain/ui_domain/configuration/parsers/ui_configuration_cbor_parser.h"
#include "domain/ui_domain/models/property_binding.h"
#include "domain/ui_domain/models/ui_configuration.h"
#include "domain/ui_domain/models/widget_property.h"
#include "domain/ui_domain/models/widget_type.h"

#include "subsys/event_bus/event_channel_id.h"

using namespace eerie_memory;
using namespace eerie_leap::domain::ui_domain::models;

using eerie_leap::configuration::cbor::CborSerializer;
using eerie_leap::domain::logging_domain::event_bus::LoggingEventType;
using eerie_leap::domain::logging_domain::event_bus::LoggingPayloadType;
using eerie_leap::domain::sensor_domain::event_bus::SensorEventType;
using eerie_leap::domain::sensor_domain::event_bus::SensorPayloadType;
using eerie_leap::domain::settings_domain::event_bus::SettingsEventType;
using eerie_leap::domain::settings_domain::event_bus::SettingsPayloadType;
using eerie_leap::domain::ui_domain::configuration::parsers::UiConfigurationCborParser;
using eerie_leap::domain::ui_domain::event_bus::NavigationEventType;
using eerie_leap::domain::ui_domain::event_bus::NavigationPayloadType;
using eerie_leap::subsys::event_bus::EventChannelId;
using eerie_leap::utilities::memory::Mrm;

namespace {

// A stored UI configuration with one binding of each shape, captured once from the encoder before
// EventBinding moved to rt_core. A mismatch means stored UI configurations no longer read the same:
// fix the code, never the bytes.
//
// zcbor without ZCBOR_CANONICAL, as the app builds it, opens every list with 0x9f and closes it with
// 0xff. A binding record is [target, channel, event_type, payload_key, direction,
// outbound_event_type, has_selector, selector_key, selector_value]; a target of 24 or more takes
// two bytes (0x18 nn), and an absent selector still encodes the placeholder 0.
// clang-format off: each row holds the bytes its comment describes, and the longer rows pass the column limit.
const uint8_t STORED_CONFIGURATION[] = {
    0x9f, 0x01, 0x01, 0x9f,                                     // [version 1, active group 1, screens [
    0x9f, 0x01, 0x01, 0x02, 0x00, 0xf5, 0xf4,                   //   [id 1, group 1, Gauge, z 0, visible, not overlay,
    0x9f, 0xf4, 0x01, 0x01, 0x00, 0xff, 0x9f,                   //    grid [no snap, 1, 1, 0], widgets [
    0x9f, 0x1a, 0x00, 0x02, 0x00, 0x66, 0x01,                   //     [IndicatorDigital, id 1,
    0x9f, 0x00, 0x00, 0xff, 0x9f, 0x01, 0x01, 0xff, 0x00, 0x9f, //      position [0, 0], size [1, 1], z 0, bindings [
    0x9f, 0x18, 0x1b, 0x01, 0x00, 0x01, 0x00, 0x00, 0xf5, 0x00, // VALUE, Sensors, DataUpdated, Value, In, 0, SensorId
    0x68, 0x73, 0x65, 0x6e, 0x73, 0x6f, 0x72, 0x5f, 0x31, 0xff, //   "sensor_1"
    0x9f, 0x18, 0x1a, 0x02, 0x00, 0x00, 0x00, 0x00, 0xf4, 0x00, // IS_VISIBLE, Logging, StatusUpdated, IsActive, In, 0, none
    0x00, 0xff,                                                 //   placeholder 0
    0x9f, 0x03, 0x01, 0x00, 0x01, 0x00, 0x00, 0xf5, 0x00,       // MIN_VALUE, Sensors, DataUpdated, Value, In, 0, SensorId
    0x07, 0xff,                                                 //   7
    0x9f, 0x18, 0x22, 0x02, 0x00, 0x01, 0x00, 0x00, 0xf5, 0x00, // OPACITY, Logging, StatusUpdated, Reason, In, 0, IsActive
    0xf5, 0xff,                                                 //   true
    0x9f, 0x04, 0x04, 0x00, 0x01, 0x02, 0x02, 0xf5, 0x00,       // MAX_VALUE, Settings, Changed, Value, InOut, ChangeRequested, SettingId
    0x6a, 0x62, 0x72, 0x69, 0x67, 0x68, 0x74, 0x6e, 0x65, 0x73, //   "brightness"
    0x73, 0xff,
    0x9f, 0x18, 0x19, 0x03, 0x00, 0x01, 0x01, 0x00, 0xf5, 0x00, // TARGET_SCREEN_GROUP, Navigation, Changed, TargetGroupId, Out, Changed, Action
    0x21, 0xff,                                                 //   -2
    0xff, 0xff, 0xff, 0xff, 0xff, 0xff                          // bindings, widget, widgets, screen, screens, configuration
};
// clang-format on

BUILD_ASSERT(
    !IS_ENABLED(CONFIG_ZCBOR_CANONICAL),
    "The stored bytes are those of non-canonical zcbor, as the app builds it."
);

PropertyBinding MakeBinding(
    WidgetPropertyType target,
    EventChannelId channel,
    uint32_t event_type,
    uint32_t payload_key,
    PropertyBindingDirection direction,
    uint32_t outbound_event_type,
    uint32_t selector_key,
    ConfigValue selector_value
) {

    return PropertyBinding{ .target = target,
        .event = { .channel = channel,
            .event_type = event_type,
            .payload_key = payload_key,
            .selector_key = selector_key,
            .selector_value = std::move(selector_value) },
        .direction = direction,
        .outbound_event_type = outbound_event_type };
}

// No properties at any level, since property maps encode in unordered_map order, and one widget,
// so ordering by z-index on load cannot move anything.
PmrUniquePtr<UiConfiguration> MakeStoredConfiguration() {
    auto configuration = make_unique_pmr<UiConfiguration>(Mrm::GetDefaultPmr());
    configuration->active_screen_group_id = 1;

    auto screen = make_shared_pmr<ScreenConfiguration>(Mrm::GetDefaultPmr());
    screen->id = 1;
    screen->screen_group_id = 1;
    screen->type = ScreenType::Gauge;
    screen->z_index = 0;
    screen->is_visible = true;
    screen->is_overlay = false;
    screen->grid = { .snap_enabled = false, .width = 1, .height = 1, .spacing_px = 0 };

    auto widget = make_shared_pmr<WidgetConfiguration>(Mrm::GetDefaultPmr());
    widget->type = WidgetType::IndicatorDigital;
    widget->id = 1;
    widget->position_grid = { 0, 0 };
    widget->size_grid = { 1, 1 };
    widget->z_index = 0;

    auto& bindings = widget->bindings;

    // A sensor selected by its text id.
    bindings.push_back(MakeBinding(
        WidgetPropertyType::VALUE, EventChannelId::Sensors, std::to_underlying(SensorEventType::DataUpdated),
        std::to_underlying(SensorPayloadType::Value), PropertyBindingDirection::In, 0,
        std::to_underlying(SensorPayloadType::SensorId), std::pmr::string("sensor_1")
    ));

    // Unconditional.
    bindings.push_back(MakeBinding(
        WidgetPropertyType::IS_VISIBLE, EventChannelId::Logging, std::to_underlying(LoggingEventType::StatusUpdated),
        std::to_underlying(LoggingPayloadType::IsActive), PropertyBindingDirection::In, 0, 0, ConfigValue{}
    ));

    // An integer selector.
    bindings.push_back(MakeBinding(
        WidgetPropertyType::MIN_VALUE, EventChannelId::Sensors, std::to_underlying(SensorEventType::DataUpdated),
        std::to_underlying(SensorPayloadType::Value), PropertyBindingDirection::In, 0,
        std::to_underlying(SensorPayloadType::SensorId), 7
    ));

    // A bool selector.
    bindings.push_back(MakeBinding(
        WidgetPropertyType::OPACITY, EventChannelId::Logging, std::to_underlying(LoggingEventType::StatusUpdated),
        std::to_underlying(LoggingPayloadType::Reason), PropertyBindingDirection::In, 0,
        std::to_underlying(LoggingPayloadType::IsActive), true
    ));

    // Two-way, with the event the widget publishes when the user moves it.
    bindings.push_back(MakeBinding(
        WidgetPropertyType::MAX_VALUE, EventChannelId::Settings, std::to_underlying(SettingsEventType::Changed),
        std::to_underlying(SettingsPayloadType::Value), PropertyBindingDirection::InOut,
        std::to_underlying(SettingsEventType::ChangeRequested), std::to_underlying(SettingsPayloadType::SettingId),
        std::pmr::string("brightness")
    ));

    // Outbound only, with a negative integer selector.
    bindings.push_back(MakeBinding(
        WidgetPropertyType::TARGET_SCREEN_GROUP, EventChannelId::Navigation,
        std::to_underlying(NavigationEventType::Changed), std::to_underlying(NavigationPayloadType::TargetGroupId),
        PropertyBindingDirection::Out, std::to_underlying(NavigationEventType::Changed),
        std::to_underlying(NavigationPayloadType::Action), -2
    ));

    screen->AddWidget(std::move(widget));
    configuration->screen_configurations.push_back(std::move(screen));

    return configuration;
}

// The stored bytes with the integer selector 7 of the MIN_VALUE binding replaced by @p selector.
std::vector<uint8_t> WithSelectorBytes(std::span<const uint8_t> selector) {
    constexpr uint8_t MARK[] = { 0x9f, 0x03, 0x01, 0x00, 0x01, 0x00, 0x00, 0xf5, 0x00 };

    std::vector<uint8_t> bytes(std::begin(STORED_CONFIGURATION), std::end(STORED_CONFIGURATION));
    const auto mark = std::ranges::search(bytes, MARK).begin();
    const auto value = mark + sizeof(MARK);
    bytes.erase(value);
    bytes.insert(value, selector.begin(), selector.end());

    return bytes;
}

// For diagnosis only: the array a mismatch would have to be compared against.
void PrintBytes(std::span<const uint8_t> bytes) {
    printk("Encoded %u bytes:\n", static_cast<unsigned>(bytes.size()));

    for(size_t i = 0; i < bytes.size(); ++i)
        printk("0x%02x,%s", bytes[i], (i % 12 == 11 || i + 1 == bytes.size()) ? "\n" : " ");
}

} // namespace

ZTEST_SUITE(ui_configuration_binding_bytes, NULL, NULL, NULL, NULL, NULL);

ZTEST(ui_configuration_binding_bytes, test_bindings_encode_to_the_stored_bytes) {
    auto configuration = MakeStoredConfiguration();
    auto cbor_configuration = UiConfigurationCborParser().Serialize(*configuration);
    auto bytes = CborSerializer<CborUiConfig>().Serialize(*cbor_configuration);

    const bool matches = bytes.size() == sizeof(STORED_CONFIGURATION)
        && std::memcmp(bytes.data(), STORED_CONFIGURATION, bytes.size()) == 0;

    if(!matches)
        PrintBytes(bytes);

    zassert_true(matches, "The encoder no longer writes the stored bytes.");
}

ZTEST(ui_configuration_binding_bytes, test_stored_bytes_decode_to_the_same_bindings) {
    auto cbor_configuration = CborSerializer<CborUiConfig>().Deserialize(STORED_CONFIGURATION);
    zassert_not_null(cbor_configuration.get());

    auto configuration = UiConfigurationCborParser().Deserialize(Mrm::GetDefaultPmr(), *cbor_configuration);

    zassert_equal(configuration->screen_configurations.size(), 1U);
    zassert_equal(configuration->screen_configurations[0]->widget_configurations.size(), 1U);

    const auto& bindings = configuration->screen_configurations[0]->widget_configurations[0]->bindings;
    zassert_equal(bindings.size(), 6U);

    // Channels as the literal values stored configurations carry.
    zassert_equal(bindings[0].target, WidgetPropertyType::VALUE);
    zassert_equal(std::to_underlying(bindings[0].event.channel), 1U);
    zassert_equal(bindings[0].event.event_type, std::to_underlying(SensorEventType::DataUpdated));
    zassert_equal(bindings[0].event.payload_key, std::to_underlying(SensorPayloadType::Value));
    zassert_equal(bindings[0].direction, PropertyBindingDirection::In);
    zassert_equal(bindings[0].outbound_event_type, 0U);
    zassert_true(bindings[0].event.HasSelector());
    zassert_equal(bindings[0].event.selector_key, std::to_underlying(SensorPayloadType::SensorId));
    zassert_true(std::get<std::pmr::string>(bindings[0].event.selector_value) == "sensor_1");

    zassert_equal(bindings[1].target, WidgetPropertyType::IS_VISIBLE);
    zassert_equal(std::to_underlying(bindings[1].event.channel), 2U);
    zassert_equal(bindings[1].event.event_type, std::to_underlying(LoggingEventType::StatusUpdated));
    zassert_equal(bindings[1].event.payload_key, std::to_underlying(LoggingPayloadType::IsActive));
    zassert_equal(bindings[1].direction, PropertyBindingDirection::In);
    zassert_equal(bindings[1].outbound_event_type, 0U);
    zassert_false(bindings[1].event.HasSelector());
    zassert_equal(bindings[1].event.selector_key, 0U);

    zassert_equal(bindings[2].target, WidgetPropertyType::MIN_VALUE);
    zassert_equal(std::to_underlying(bindings[2].event.channel), 1U);
    zassert_equal(bindings[2].event.event_type, std::to_underlying(SensorEventType::DataUpdated));
    zassert_equal(bindings[2].event.payload_key, std::to_underlying(SensorPayloadType::Value));
    zassert_equal(bindings[2].direction, PropertyBindingDirection::In);
    zassert_equal(bindings[2].outbound_event_type, 0U);
    zassert_true(bindings[2].event.HasSelector());
    zassert_equal(bindings[2].event.selector_key, std::to_underlying(SensorPayloadType::SensorId));
    zassert_equal(std::get<int>(bindings[2].event.selector_value), 7);

    zassert_equal(bindings[3].target, WidgetPropertyType::OPACITY);
    zassert_equal(std::to_underlying(bindings[3].event.channel), 2U);
    zassert_equal(bindings[3].event.event_type, std::to_underlying(LoggingEventType::StatusUpdated));
    zassert_equal(bindings[3].event.payload_key, std::to_underlying(LoggingPayloadType::Reason));
    zassert_equal(bindings[3].direction, PropertyBindingDirection::In);
    zassert_equal(bindings[3].outbound_event_type, 0U);
    zassert_true(bindings[3].event.HasSelector());
    zassert_equal(bindings[3].event.selector_key, std::to_underlying(LoggingPayloadType::IsActive));
    zassert_true(std::get<bool>(bindings[3].event.selector_value));

    zassert_equal(bindings[4].target, WidgetPropertyType::MAX_VALUE);
    zassert_equal(std::to_underlying(bindings[4].event.channel), 4U);
    zassert_equal(bindings[4].event.event_type, std::to_underlying(SettingsEventType::Changed));
    zassert_equal(bindings[4].event.payload_key, std::to_underlying(SettingsPayloadType::Value));
    zassert_equal(bindings[4].direction, PropertyBindingDirection::InOut);
    zassert_equal(bindings[4].outbound_event_type, std::to_underlying(SettingsEventType::ChangeRequested));
    zassert_true(bindings[4].event.HasSelector());
    zassert_equal(bindings[4].event.selector_key, std::to_underlying(SettingsPayloadType::SettingId));
    zassert_true(std::get<std::pmr::string>(bindings[4].event.selector_value) == "brightness");

    zassert_equal(bindings[5].target, WidgetPropertyType::TARGET_SCREEN_GROUP);
    zassert_equal(std::to_underlying(bindings[5].event.channel), 3U);
    zassert_equal(bindings[5].event.event_type, std::to_underlying(NavigationEventType::Changed));
    zassert_equal(bindings[5].event.payload_key, std::to_underlying(NavigationPayloadType::TargetGroupId));
    zassert_equal(bindings[5].direction, PropertyBindingDirection::Out);
    zassert_equal(bindings[5].outbound_event_type, std::to_underlying(NavigationEventType::Changed));
    zassert_true(bindings[5].event.HasSelector());
    zassert_equal(bindings[5].event.selector_key, std::to_underlying(NavigationPayloadType::Action));
    zassert_equal(std::get<int>(bindings[5].event.selector_value), -2);
}

ZTEST(ui_configuration_binding_bytes, test_selector_written_as_uint32_reads_as_the_same_32_bits) {
    constexpr uint8_t SELECTOR[] = { 0x1a, 0xff, 0xff, 0xff, 0xff }; // 4294967295
    const auto bytes = WithSelectorBytes(SELECTOR);

    auto cbor_configuration = CborSerializer<CborUiConfig>().Deserialize(bytes);
    zassert_not_null(cbor_configuration.get());

    auto configuration = UiConfigurationCborParser().Deserialize(Mrm::GetDefaultPmr(), *cbor_configuration);
    const auto& bindings = configuration->screen_configurations[0]->widget_configurations[0]->bindings;

    zassert_equal(std::get<int>(bindings[2].event.selector_value), -1);
}

ZTEST(ui_configuration_binding_bytes, test_selector_above_uint32_is_refused) {
    constexpr uint8_t SELECTOR[] = { 0x1b, 0x00, 0x00, 0x00, 0x01, 0x00, 0x00, 0x00, 0x00 }; // 0x1_0000_0000
    const auto bytes = WithSelectorBytes(SELECTOR);

    zassert_is_null(CborSerializer<CborUiConfig>().Deserialize(bytes).get());
}

ZTEST(ui_configuration_binding_bytes, test_selector_below_int32_is_refused) {
    constexpr uint8_t SELECTOR[] = { 0x3b, 0x00, 0x00, 0x00, 0x00, 0x80, 0x00, 0x00, 0x00 }; // -2147483649
    const auto bytes = WithSelectorBytes(SELECTOR);

    zassert_is_null(CborSerializer<CborUiConfig>().Deserialize(bytes).get());
}

namespace {

// One widget with one binding of its box, as the encoder writes it. A target of 45 takes two bytes (0x18 0x2d).
// clang-format off: each row holds the bytes its comment describes.
const uint8_t LAYOUT_BINDING_CONFIGURATION[] = {
    0x9f, 0x01, 0x01, 0x9f,                                     // [version 1, active group 1, screens [
    0x9f, 0x01, 0x01, 0x02, 0x00, 0xf5, 0xf4,                   //   [id 1, group 1, Gauge, z 0, visible, not overlay,
    0x9f, 0xf4, 0x01, 0x01, 0x00, 0xff, 0x9f,                   //    grid [no snap, 1, 1, 0], widgets [
    0x9f, 0x1a, 0x00, 0x02, 0x00, 0x66, 0x01,                   //     [IndicatorDigital, id 1,
    0x9f, 0x00, 0x00, 0xff, 0x9f, 0x01, 0x01, 0xff, 0x00, 0x9f, //      position [0, 0], size [1, 1], z 0, bindings [
    0x9f, 0x18, 0x2d, 0x01, 0x00, 0x01, 0x00, 0x00, 0xf5, 0x00, // LAYOUT_X, Sensors, DataUpdated, Value, In, 0, SensorId
    0x68, 0x73, 0x65, 0x6e, 0x73, 0x6f, 0x72, 0x5f, 0x31, 0xff, //   "sensor_1"
    0xff, 0xff, 0xff, 0xff, 0xff, 0xff                          // bindings, widget, widgets, screen, screens, configuration
};
// clang-format on

PmrUniquePtr<UiConfiguration> MakeLayoutBindingConfiguration() {
    auto configuration = make_unique_pmr<UiConfiguration>(Mrm::GetDefaultPmr());
    configuration->active_screen_group_id = 1;

    auto screen = make_shared_pmr<ScreenConfiguration>(Mrm::GetDefaultPmr());
    screen->id = 1;
    screen->screen_group_id = 1;
    screen->z_index = 0;
    screen->is_visible = true;
    screen->is_overlay = false;
    screen->type = ScreenType::Gauge;
    screen->grid = { .snap_enabled = false, .width = 1, .height = 1, .spacing_px = 0 };

    auto widget = make_shared_pmr<WidgetConfiguration>(Mrm::GetDefaultPmr());
    widget->type = WidgetType::IndicatorDigital;
    widget->id = 1;
    widget->position_grid = { 0, 0 };
    widget->size_grid = { 1, 1 };
    widget->z_index = 0;
    widget->bindings.push_back(MakeBinding(
        WidgetPropertyType::LAYOUT_X, EventChannelId::Sensors, std::to_underlying(SensorEventType::DataUpdated),
        std::to_underlying(SensorPayloadType::Value), PropertyBindingDirection::In, 0,
        std::to_underlying(SensorPayloadType::SensorId), std::pmr::string("sensor_1")
    ));

    screen->AddWidget(std::move(widget));
    configuration->screen_configurations.push_back(std::move(screen));

    return configuration;
}

} // namespace

// A binding to the box's X is a binding like any other, with the target 45.
ZTEST(ui_configuration_binding_bytes, test_a_binding_to_the_box_encodes_with_the_target_45) {
    zassert_equal(static_cast<int>(WidgetPropertyType::LAYOUT_X), 45);

    auto configuration = MakeLayoutBindingConfiguration();
    auto cbor_configuration = UiConfigurationCborParser().Serialize(*configuration);
    auto bytes = CborSerializer<CborUiConfig>().Serialize(*cbor_configuration);

    const bool matches = bytes.size() == sizeof(LAYOUT_BINDING_CONFIGURATION)
        && std::memcmp(bytes.data(), LAYOUT_BINDING_CONFIGURATION, bytes.size()) == 0;

    if(!matches)
        PrintBytes(bytes);

    zassert_true(matches, "The encoder no longer writes a binding to the box as it did.");
}

ZTEST(ui_configuration_binding_bytes, test_the_bytes_of_a_binding_to_the_box_decode_to_the_target_45) {
    auto cbor_configuration = CborSerializer<CborUiConfig>().Deserialize(LAYOUT_BINDING_CONFIGURATION);
    zassert_not_null(cbor_configuration.get());

    auto configuration = UiConfigurationCborParser().Deserialize(Mrm::GetDefaultPmr(), *cbor_configuration);
    const auto& bindings = configuration->screen_configurations[0]->widget_configurations[0]->bindings;

    zassert_equal(bindings.size(), 1U);
    zassert_equal(bindings[0].target, WidgetPropertyType::LAYOUT_X);
    zassert_equal(bindings[0].direction, PropertyBindingDirection::In);
    zassert_true(std::get<std::pmr::string>(bindings[0].event.selector_value) == "sensor_1");
}

// 51 (COUNT) is the first property no firmware knows, in a binding as in a map.
ZTEST(ui_configuration_binding_bytes, test_a_target_past_the_box_properties_is_refused) {
    std::vector<uint8_t> bytes(std::begin(LAYOUT_BINDING_CONFIGURATION), std::end(LAYOUT_BINDING_CONFIGURATION));
    const uint8_t layout_target[] = { 0x9f, 0x18, 0x2d };
    const auto mark = std::ranges::search(bytes, layout_target).begin();
    *(mark + 2) = 0x33; // 51

    auto cbor_configuration = CborSerializer<CborUiConfig>().Deserialize(bytes);
    zassert_not_null(cbor_configuration.get());

    bool is_refused = false;
    try {
        UiConfigurationCborParser().Deserialize(Mrm::GetDefaultPmr(), *cbor_configuration);
    } catch(const std::invalid_argument&) {
        is_refused = true;
    }

    zassert_true(is_refused, "Expected the target 51 to be unknown.");
}
```

## src/widget_property.cpp
```c
#include <array>

#include <zephyr/ztest.h>

#include "domain/ui_domain/models/animation.h"
#include "domain/ui_domain/models/icon_type.h"
#include "domain/ui_domain/models/widget_direction.h"
#include "domain/ui_domain/models/widget_fill_mode.h"
#include "domain/ui_domain/models/widget_property.h"
#include "domain/ui_domain/utilities/widget_property_validator.h"
#include "utilities/type/color.h"

using namespace eerie_leap::domain::ui_domain::models;
using eerie_leap::utilities::type::Color;

ZTEST_SUITE(widget_property, NULL, NULL, NULL, NULL, NULL);

namespace {

constexpr std::array ALL_TYPES = { WidgetPropertyType::NONE, WidgetPropertyType::IS_ACTIVE,
    WidgetPropertyType::IS_SMOOTHED, WidgetPropertyType::MIN_VALUE, WidgetPropertyType::MAX_VALUE,
    WidgetPropertyType::CHART_POINT_COUNT, WidgetPropertyType::CHART_TYPE, WidgetPropertyType::LABEL,
    WidgetPropertyType::VALUE_PRECISION, WidgetPropertyType::EDGE_OFFSET, WidgetPropertyType::POSITION_X,
    WidgetPropertyType::POSITION_Y, WidgetPropertyType::POSITION_ANGLE, WidgetPropertyType::ICON_TYPE,
    WidgetPropertyType::START_ANGLE, WidgetPropertyType::END_ANGLE, WidgetPropertyType::FILE_PATH,
    WidgetPropertyType::IMG_WIDTH, WidgetPropertyType::IMG_HEIGHT, WidgetPropertyType::ANCHOR_POINT_X,
    WidgetPropertyType::ANCHOR_POINT_Y, WidgetPropertyType::DIRECTION, WidgetPropertyType::SETTING_ID,
    WidgetPropertyType::STEP, WidgetPropertyType::UNIT, WidgetPropertyType::TARGET_SCREEN_GROUP,
    WidgetPropertyType::IS_VISIBLE, WidgetPropertyType::VALUE, WidgetPropertyType::NAVIGATION_INTENT,
    WidgetPropertyType::WIDTH_PX, WidgetPropertyType::HEIGHT_PX, WidgetPropertyType::STROKE_PX,
    WidgetPropertyType::CORNER_RAD_PX, WidgetPropertyType::FILL_MODE, WidgetPropertyType::OPACITY,
    WidgetPropertyType::COLOR_PRIMARY_ACTIVE, WidgetPropertyType::COLOR_PRIMARY_INACTIVE,
    WidgetPropertyType::COLOR_SECONDARY_ACTIVE, WidgetPropertyType::COLOR_SECONDARY_INACTIVE,
    WidgetPropertyType::COLOR_TERTIARY_ACTIVE, WidgetPropertyType::COLOR_TERTIARY_INACTIVE,
    WidgetPropertyType::ANIMATION_TYPE, WidgetPropertyType::IS_ANIMATION_ACTIVE,
    WidgetPropertyType::ANIMATION_DURATION_MS, WidgetPropertyType::CHILD_WIDGET_IDS, WidgetPropertyType::LAYOUT_X,
    WidgetPropertyType::LAYOUT_Y, WidgetPropertyType::LAYOUT_WIDTH, WidgetPropertyType::LAYOUT_HEIGHT,
    WidgetPropertyType::FONT_FILE_PATH, WidgetPropertyType::FONT_SIZE_PX };

} // namespace

ZTEST(widget_property, test_shape_additions_preserve_persisted_values) {
    // Removing the dot icon deliberately renumbered the icon types after Label.
    zassert_equal(static_cast<int>(IconType::Image), 2);
    zassert_equal(static_cast<int>(IconType::Svg), 3);
    zassert_equal(static_cast<int>(WidgetPropertyType::NAVIGATION_INTENT), 28);
    zassert_equal(static_cast<int>(WidgetPropertyType::DIRECTION), 21);
    zassert_equal(static_cast<int>(WidgetDirection::None), 0);
    zassert_equal(static_cast<int>(WidgetDirection::LeftToRight), 1);
    zassert_equal(static_cast<int>(WidgetDirection::RightToLeft), 2);
    zassert_equal(static_cast<int>(WidgetDirection::TopToBottom), 3);
    zassert_equal(static_cast<int>(WidgetDirection::BottomToTop), 4);
    zassert_equal(static_cast<int>(WidgetFillMode::Filled), 0);
    zassert_equal(static_cast<int>(WidgetFillMode::Outline), 1);
}

// Persisted numeric IDs must stay stable when properties are added.
ZTEST(widget_property, test_property_ids_preserve_persisted_values) {
    zassert_equal(ALL_TYPES.size(), 51);
    zassert_equal(static_cast<uint16_t>(WidgetPropertyType::COUNT), ALL_TYPES.size());
    zassert_equal(static_cast<uint16_t>(WidgetPropertyType::ANCHOR_POINT_X), 19);
    zassert_equal(static_cast<uint16_t>(WidgetPropertyType::ANCHOR_POINT_Y), 20);
    zassert_equal(static_cast<uint16_t>(WidgetPropertyType::CHILD_WIDGET_IDS), 44);
    zassert_equal(static_cast<uint16_t>(WidgetPropertyType::LAYOUT_X), 45);
    zassert_equal(static_cast<uint16_t>(WidgetPropertyType::LAYOUT_Y), 46);
    zassert_equal(static_cast<uint16_t>(WidgetPropertyType::LAYOUT_WIDTH), 47);
    zassert_equal(static_cast<uint16_t>(WidgetPropertyType::LAYOUT_HEIGHT), 48);
    zassert_equal(static_cast<uint16_t>(WidgetPropertyType::FONT_FILE_PATH), 49);
    zassert_equal(static_cast<uint16_t>(WidgetPropertyType::FONT_SIZE_PX), 50);
    for(size_t index = 0; index < ALL_TYPES.size(); ++index)
        zassert_equal(static_cast<uint16_t>(ALL_TYPES[index]), index);
}

ZTEST(widget_property, test_every_property_type_is_valid) {
    for(auto type : ALL_TYPES)
        zassert_equal(IsValidWidgetPropertyType(type), type != WidgetPropertyType::NONE);
}

ZTEST(widget_property, test_animation_ids_defaults_and_duration_contract) {
    zassert_equal(static_cast<int>(Animation::Type::None), 0);
    zassert_equal(static_cast<int>(Animation::Type::Blinking), 1);
    zassert_equal(static_cast<int>(Animation::Type::Rotation), 2);
    zassert_equal(Animation::DEFAULT_TYPE, Animation::Type::None);
    zassert_false(Animation::DEFAULT_ACTIVE);
    zassert_equal(Animation::DEFAULT_DURATION_MS, 1000);
    zassert_equal(Animation::MIN_DURATION_MS, 2);
    zassert_equal(Animation::MAX_DURATION_MS, INT32_MAX);
}

ZTEST(widget_property, test_sentinels_and_unknown_types_are_invalid) {
    zassert_false(IsValidWidgetPropertyType(WidgetPropertyType::NONE));
    zassert_false(IsValidWidgetPropertyType(WidgetPropertyType::COUNT));
    zassert_false(IsValidWidgetPropertyType(static_cast<WidgetPropertyType>(9999)));
    zassert_false(IsValidWidgetPropertyType(static_cast<WidgetPropertyType>(UINT16_MAX)));
}

ZTEST(widget_property, test_color_parser_requires_explicit_rgba) {
    for(const auto* text : { "#3366FF80", "#3366ff80", "#3366fF80" }) {
        const auto parsed = Color::TryParse(text);
        zassert_true(parsed.has_value());
        zassert_true(parsed->has_value());
        const auto& color = **parsed;
        zassert_equal(color.red, 0x33);
        zassert_equal(color.green, 0x66);
        zassert_equal(color.blue, 0xff);
        zassert_equal(color.alpha, 0x80);
    }

    auto parsed = Color::TryParse("#12345678");
    zassert_true(parsed.has_value());
    zassert_true((*parsed == Color{ 0x12, 0x34, 0x56, 0x78 }));
    parsed = Color::TryParse("#FFFFFFFF");
    zassert_true(parsed.has_value());
    zassert_true((*parsed == Color{ 255, 255, 255, 255 }));
}

ZTEST(widget_property, test_color_parser_distinguishes_transparent_override_from_reset) {
    const auto transparent = Color::TryParse("#00000000");
    zassert_true(transparent.has_value());
    zassert_true((*transparent == Color{ 0, 0, 0, 0 }));
    const auto reset = Color::TryParse("");
    zassert_true(reset.has_value());
    zassert_false(reset->has_value());
}

ZTEST(widget_property, test_color_parser_reports_invalid_argument_for_malformed_input) {
    constexpr std::string_view INVALID_VALUES[] = { "#3366FF", "3366FF80", "#1234567", "#123456789", " #12345678",
        "#12345678 ", "#GG345678", "#12GG5678", "#1234GG78", "#123456GG", "#+1345678", "#-1345678", "#1 345678",
        "#0x345678", "#1234567#", std::string_view("#1234567\0", 9), std::string_view("#12345678\0", 10) };
    for(auto text : INVALID_VALUES) {
        const auto parsed = Color::TryParse(text);
        zassert_false(parsed.has_value(), "Accepted malformed color: %.*s", static_cast<int>(text.size()), text.data());
        zassert_true(parsed.error() == std::errc::invalid_argument);
    }
}

// The box's four properties are exactly 45 to 48; no other property is one.
ZTEST(widget_property, test_only_the_box_properties_are_layout_properties) {
    using eerie_leap::domain::ui_domain::utilities::WidgetPropertyValidator;

    for(auto type : ALL_TYPES) {
        const auto id = static_cast<uint16_t>(type);
        zassert_equal(WidgetPropertyValidator::IsLayoutProperty(type), id >= 45 && id <= 48, "property %u", id);
    }
}
```

## src/widget_type.cpp
```c
#include <array>
#include <cstdint>

#include <zephyr/ztest.h>

#include "domain/ui_domain/models/widget_type.h"

using namespace eerie_leap::domain::ui_domain::models;

ZTEST_SUITE(widget_type, NULL, NULL, NULL, NULL, NULL);

ZTEST(widget_type, test_category_is_resolved_per_type) {
    zassert_equal(WidgetTypeHelpers::GetCategory(WidgetType::BasicIcon), WidgetCategory::Basic);
    zassert_equal(WidgetTypeHelpers::GetCategory(WidgetType::BasicLottie), WidgetCategory::Basic);
    zassert_equal(WidgetTypeHelpers::GetCategory(WidgetType::IndicatorDial), WidgetCategory::Indicator);
    zassert_equal(WidgetTypeHelpers::GetCategory(WidgetType::ControlSlider), WidgetCategory::Control);
    zassert_equal(WidgetTypeHelpers::GetCategory(WidgetType::None), WidgetCategory::None);
}

// It renders a setting read-only and drives nothing, so it must not be grouped
// with the widgets that write one.
ZTEST(widget_type, test_setting_backed_display_is_an_indicator) {
    zassert_equal(WidgetTypeHelpers::GetCategory(WidgetType::IndicatorSetting), WidgetCategory::Indicator);
    zassert_false(WidgetTypeHelpers::IsCategory(WidgetType::IndicatorSetting, WidgetCategory::Control));
}

// Control (3 << 16) shares bits with Basic (1 << 16) and Indicator (2 << 16), so
// a plain bitwise AND reports a control widget as being in either of them.
ZTEST(widget_type, test_control_type_is_not_reported_as_another_category) {
    zassert_true(WidgetTypeHelpers::IsCategory(WidgetType::ControlSlider, WidgetCategory::Control));
    zassert_false(WidgetTypeHelpers::IsCategory(WidgetType::ControlSlider, WidgetCategory::Basic));
    zassert_false(WidgetTypeHelpers::IsCategory(WidgetType::ControlSlider, WidgetCategory::Indicator));
}

ZTEST(widget_type, test_indicator_type_is_not_reported_as_basic) {
    zassert_true(WidgetTypeHelpers::IsCategory(WidgetType::IndicatorBar, WidgetCategory::Indicator));
    zassert_false(WidgetTypeHelpers::IsCategory(WidgetType::IndicatorBar, WidgetCategory::Basic));
    zassert_false(WidgetTypeHelpers::IsCategory(WidgetType::IndicatorBar, WidgetCategory::Control));
}

ZTEST(widget_type, test_types_are_unique) {
    constexpr std::array TYPES = { WidgetType::BasicIcon, WidgetType::BasicArcIcon, WidgetType::BasicLottie,
        WidgetType::IndicatorArcFill, WidgetType::IndicatorDigital, WidgetType::IndicatorHorizontalChart,
        WidgetType::IndicatorSegmentArc, WidgetType::IndicatorDial, WidgetType::IndicatorBar,
        WidgetType::IndicatorSetting, WidgetType::ControlSlider, WidgetType::ControlToggle, WidgetType::ControlButton };

    for(size_t i = 0; i < TYPES.size(); i++)
        for(size_t j = i + 1; j < TYPES.size(); j++)
            zassert_not_equal(
                static_cast<uint32_t>(TYPES[i]), static_cast<uint32_t>(TYPES[j]),
                "Widget types at %zu and %zu collide.", i, j
            );
}
```
