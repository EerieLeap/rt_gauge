## CMakeLists.txt
```
cmake_minimum_required(VERSION 3.20.0)

set(RT_GAUGE_TEST_SIM_FLASH ON)

# Deliberately NOT RT_GAUGE_TEST_LVGL: UiController goes through UiRendererService,
# which refuses to start without a chosen display, so this suite binds LVGL to the
# dummy display driver (see boards/native_sim.overlay) instead of running headless.
include(${CMAKE_CURRENT_SOURCE_DIR}/../../rt_gauge_test.cmake)

# Use Zephyr's build system
find_package(Zephyr REQUIRED HINTS $ENV{ZEPHYR_BASE})
project(functional_controllers)

include(${RT_GAUGE_DIR}/cmake/lvgl_vector.cmake)
include(${RT_GAUGE_DIR}/cmake/builtin_fonts.cmake)

include_directories(${APP_SRC_DIR})
include_directories(${RT_GAUGE_DIR}/tests/common)

set(APP_SRC_CONFIGURATION_DIR ${APP_SRC_DIR}/configuration)
file(GLOB_RECURSE APP_SRC_CONFIGURATION
  ${APP_SRC_CONFIGURATION_DIR}/*.c
  ${APP_SRC_CONFIGURATION_DIR}/*.cpp
)

set(APP_SRC_UI_DOMAIN_DIR ${APP_SRC_DIR}/domain/ui_domain)
file(GLOB_RECURSE APP_SRC_UI_DOMAIN
  ${APP_SRC_UI_DOMAIN_DIR}/*.c
  ${APP_SRC_UI_DOMAIN_DIR}/*.cpp
)

# DisplayService persists the unit's own brightness through the display configuration manager; the
# dummy display is what it drives.
set(APP_SRC_DISPLAY_DOMAIN_DIR ${APP_SRC_DIR}/domain/display_domain)
file(GLOB_RECURSE APP_SRC_DISPLAY_DOMAIN
  ${APP_SRC_DISPLAY_DOMAIN_DIR}/*.c
  ${APP_SRC_DISPLAY_DOMAIN_DIR}/*.cpp
)

# InitializeEventChannels() registers the channels that widget bindings resolve through.
file(GLOB_RECURSE APP_SRC_EVENT_BUS
  ${APP_SRC_DIR}/event_bus/*.c
  ${APP_SRC_DIR}/event_bus/*.cpp
)

set(APP_SRC_VIEWS_DIR ${APP_SRC_DIR}/views)
file(GLOB_RECURSE APP_SRC_VIEWS
  ${APP_SRC_VIEWS_DIR}/*.c
  ${APP_SRC_VIEWS_DIR}/*.cpp
)

# LottieWidget keeps ThorVG on the external heap.
set(APP_SRC_UTILITIES ${APP_SRC_DIR}/utilities/memory/scoped_new_resource.cpp)

# UiController only: the others pull in CAN, BLE and the sensor stack, none of which
# this suite exercises.
file(GLOB_RECURSE APP_SRC_CONTROLLERS
  ${APP_SRC_DIR}/controllers/ui_controller.cpp
)

# The UI preview a controller serves: its service. The SMP group is tested in functional/smp_ui.
set(APP_SRC_UI_PREVIEW ${APP_SRC_DIR}/domain/ui_preview_domain/ui_preview_service.cpp)

file(GLOB_RECURSE TEST_SOURCES src/*.c src/*.cpp)

# Add all source files to the app target
target_sources(app PRIVATE
  ${APP_SRC_CONFIGURATION}
  ${APP_SRC_CONTROLLERS}
  ${APP_SRC_DISPLAY_DOMAIN}
  ${APP_SRC_EVENT_BUS}
  ${APP_SRC_UI_DOMAIN}
  ${APP_SRC_UI_PREVIEW}
  ${APP_SRC_UTILITIES}
  ${APP_SRC_VIEWS}
  ${TEST_SOURCES}
)
```

## Kconfig
```
menu "Zephyr"
source "Kconfig.zephyr"
endmenu

config EERIE_LEAP_HW_VERSION_MAJOR
	int "Hardware version major"
	range 0 255
	default 0

config EERIE_LEAP_HW_VERSION_MINOR
	int "Hardware version minor"
	range 0 255
	default 0

config EERIE_LEAP_HW_VERSION_PATCH
	int "Hardware version patch"
	range 0 65535
	default 0

config EERIE_LEAP_SW_VERSION_MAJOR
	int "Software version major"
	range 0 255
	default 0

config EERIE_LEAP_SW_VERSION_MINOR
	int "Software version minor"
	range 0 255
	default 0

config EERIE_LEAP_SW_VERSION_PATCH
	int "Software version patch"
	range 0 65535
	default 0

config EERIE_LEAP_UI_RENDERER_THREAD_STACK_SIZE
	int "UI renderer thread stack size"
	default 8192

config EERIE_LEAP_UI_RENDER_WORK_QUEUE_STACK_SIZE
	int "UI render work queue stack size"
	default 8192

config EERIE_LEAP_UI_PREVIEW
	bool "UI preview"
	default y

config EERIE_LEAP_UI_PREVIEW_LEASE_MS
	int "UI preview lease"
	default 600

config EERIE_LEAP_UI_PREVIEW_MAX_STAGE_SIZE
	int "Largest staged UI configuration"
	default 65536

config EERIE_LEAP_UI_IMAGE_MAX_SIZE
	int "Largest image upload"
	default 4194304

config EERIE_LEAP_UI_ANIMATION_MAX_SIZE
	int "Largest animation upload"
	default 524288

config EERIE_LEAP_UI_FONT_MAX_SIZE
	int "Largest font upload"
	default 262144

config EERIE_LEAP_UI_BUILTIN_FONTS
	bool "Built-in fonts"
	default y

config EERIE_LEAP_UI_FONT_GLYPH_CACHE_SIZE
	int "Glyph cache of one font size"
	default 131072

config EERIE_LEAP_UI_ROTATION
	int
	default 0

config EERIE_LEAP_FLOAT_SIGNIFICANT_DIGITS
	int "Floating point significant digits"
	default 4

config EERIE_LEAP_FS_SD_THREAD_STACK_SIZE
	int "SD thread stack size"
	default 2048

config EERIE_LEAP_SD_CHECK_INTERVAL_MS
	int "SD check interval ms"
	default 1000
```

## prj.conf
```kconfig
CONFIG_ZTEST=y

#HW Version
CONFIG_EERIE_LEAP_HW_VERSION_MAJOR=2
CONFIG_EERIE_LEAP_HW_VERSION_MINOR=9
CONFIG_EERIE_LEAP_HW_VERSION_PATCH=6

#SW Version
CONFIG_EERIE_LEAP_SW_VERSION_MAJOR=7
CONFIG_EERIE_LEAP_SW_VERSION_MINOR=8
CONFIG_EERIE_LEAP_SW_VERSION_PATCH=4

# Language and Compiler
CONFIG_CPP=y
CONFIG_PICOLIBC=y
CONFIG_STD_CPP23=y
CONFIG_REQUIRES_FULL_LIBCPP=y
CONFIG_CPP_EXCEPTIONS=y
CONFIG_CPP_RTTI=y

# Memory
# Without CONFIG_SHARED_MULTI_HEAP the external PMR falls back to k_malloc.
# A "small only" sys_heap is capped at 256 KB and fails to init before logging is
# up, so the size mode has to be widened along with the pool.
CONFIG_SYS_HEAP_AUTO=y
CONFIG_HEAP_MEM_POOL_SIZE=4194304

# The controller and its work queues allocate their stacks at runtime.
CONFIG_THREAD_STACK_INFO=y
CONFIG_DYNAMIC_THREAD=y
CONFIG_DYNAMIC_THREAD_ALLOC=y

# C++ exception unwinding needs considerably more stack than the ztest defaults.
CONFIG_MAIN_STACK_SIZE=16384
CONFIG_ZTEST_STACK_SIZE=16384

# Logging And Debugging
CONFIG_LOG=y
# A fault during static init or LVGL setup loses deferred output.
CONFIG_LOG_MODE_IMMEDIATE=y
CONFIG_TEST_RANDOM_GENERATOR=y
CONFIG_THREAD_ANALYZER=y
CONFIG_THREAD_ANALYZER_USE_LOG=y
CONFIG_THREAD_RUNTIME_STATS=y
CONFIG_THREAD_NAME=y
CONFIG_SYS_HEAP_RUNTIME_STATS=y
CONFIG_THREAD_ANALYZER_ISR_STACK_USAGE=n

# FS Config
CONFIG_FLASH=y
CONFIG_FLASH_MAP=y
CONFIG_FILE_SYSTEM=y
CONFIG_FILE_SYSTEM_LITTLEFS=y
CONFIG_FILE_SYSTEM_MKFS=y

# CBOR
CONFIG_ZCBOR=y

# LVGL
# UiRendererService refuses to start without a chosen, ready display, so unlike the
# other LVGL suites this one lets LVGL auto-init against the dummy display driver.
CONFIG_DISPLAY=y
CONFIG_LVGL=y
CONFIG_LV_Z_MEM_POOL_SIZE=1048576
CONFIG_LV_USE_LOG=n
CONFIG_LV_USE_LABEL=y
CONFIG_LV_USE_IMAGE=y
CONFIG_LV_USE_VECTOR_GRAPHIC=y
CONFIG_LV_USE_CANVAS=y
CONFIG_LV_USE_THORVG=y
CONFIG_LV_USE_THORVG_INTERNAL=y
CONFIG_LV_USE_LOTTIE=y
CONFIG_LV_USE_SVG=y
CONFIG_LV_USE_FONT_COMPRESSED=y
CONFIG_LV_FONT_MONTSERRAT_20=y
CONFIG_LV_FONT_DEFAULT_UNSCII_16=y
CONFIG_LV_USE_TINY_TTF=y
CONFIG_LV_TINY_TTF_FILE_SUPPORT=y
# The images are AL88, as on the device.
CONFIG_LV_COLOR_DEPTH_8=y
CONFIG_LV_Z_BITS_PER_PIXEL=8

CONFIG_CRC=y
CONFIG_TIMING_FUNCTIONS=y

CONFIG_EERIE_LEAP_RT_CORE=y
CONFIG_EERIE_LEAP_ASSETS=y
CONFIG_EERIE_LEAP_CONFIGURATION=y
CONFIG_EERIE_LEAP_DEVICE_TREE=y
CONFIG_EERIE_LEAP_EVENT_BUS=y
CONFIG_EERIE_LEAP_FS=y
CONFIG_EERIE_LEAP_RANDOM=y
CONFIG_EERIE_LEAP_TIME=y
CONFIG_EERIE_LEAP_LUA_SCRIPT=y
CONFIG_EERIE_LEAP_EXPRESSION_ENGINE=y
```

## src/display_service_persistence.cpp
```c
#include <atomic>
#include <memory>
#include <span>

#include <zephyr/kernel.h>
#include <zephyr/ztest.h>

#include "configuration/cbor/cbor_display_config/cbor_display_config.h"
#include "configuration/services/cbor_configuration_service.h"
#include "subsys/device_tree/dt_display.h"
#include "subsys/device_tree/dt_fs.h"
#include "subsys/fs/services/fs_service.h"
#include "subsys/threading/work_queue_thread.h"

#include "domain/configuration_domain/services/configuration_service.h"
#include "domain/display_domain/configuration/display_configuration_manager.h"
#include "domain/display_domain/services/display_service.h"

using eerie_leap::configuration::services::CborConfigurationService;
using eerie_leap::domain::configuration_domain::services::ConfigurationService;
using eerie_leap::domain::display_domain::configuration::DisplayConfigurationManager;
using eerie_leap::domain::display_domain::services::DisplayService;
using eerie_leap::subsys::device_tree::DtDisplay;
using eerie_leap::subsys::device_tree::DtFs;
using eerie_leap::subsys::fs::services::FsService;
using eerie_leap::subsys::threading::WorkQueueThread;

namespace {

constexpr int CONFIG_WORK_QUEUE_STACK_SIZE = 8192;
constexpr int CONFIG_WORK_QUEUE_PRIORITY = 10;
constexpr uint8_t PERSISTED_BRIGHTNESS = 123;

// Returns once everything queued before the call has run.
bool FlushQueue(WorkQueueThread& queue) {
    auto done = std::make_shared<k_sem>();
    k_sem_init(done.get(), 0, 1);

    queue.Run([done] {
        k_sem_give(done.get());
    });

    return k_sem_take(done.get(), K_SECONDS(5)) == 0;
}

} // namespace

ZTEST_SUITE(display_service_persistence, NULL, NULL, NULL, NULL, NULL);

// The brightness the gauge's own slider sets is persisted as the display configuration, but it is the
// unit's own setting: the configuration service reports nothing, so it stops no logging network-wide
// (L9). A display configuration written from outside is reported.
ZTEST(display_service_persistence, test_the_brightness_the_unit_persists_is_stored_and_reported_to_nobody) {
    DtDisplay::Initialize();
    DtFs::InitInternalFs();
    auto fs_service = std::make_shared<FsService>(DtFs::GetInternalFsMp());
    fs_service->Format();

    auto queue = std::make_shared<WorkQueueThread>(
        "display_persist_wq", CONFIG_WORK_QUEUE_STACK_SIZE, CONFIG_WORK_QUEUE_PRIORITY
    );
    zassert_true(queue->Initialize(), "Expected the config work queue to start.");

    auto manager = std::make_shared<DisplayConfigurationManager>(
        std::make_unique<CborConfigurationService<CborDisplayConfig>>("display_config", fs_service, queue)
    );

    auto configuration_service = std::make_shared<ConfigurationService>();
    configuration_service->RegisterCborConfigurationManager(ConfigurationService::Type::Display, manager);

    auto reports = std::make_shared<std::atomic<int>>(0);
    configuration_service->RegisterConfigurationStoredHandler([reports](ConfigurationService::Type) {
        (*reports)++;
    });

    {
        DisplayService service(manager, queue);
        zassert_equal(service.Initialize(), 0, "Expected the display service to initialize.");

        zassert_equal(service.SetBrightness(PERSISTED_BRIGHTNESS), 0);
        zassert_equal(service.Persist(), 0);
        zassert_true(FlushQueue(*queue), "The persist job ran");
    }

    zassert_equal(manager->Get(true)->brightness, PERSISTED_BRIGHTNESS, "The brightness is stored");
    zassert_equal(reports->load(), 0, "and the unit's own setting is no configuration update");

    const auto cbor = configuration_service->GetCborConfiguration(ConfigurationService::Type::Display);
    zassert_true(configuration_service->ApplyCborConfiguration(
        ConfigurationService::Type::Display, std::span<const uint8_t>(cbor.data(), cbor.size())
    ));
    zassert_equal(reports->load(), 1, "while a configuration written to the unit is");

    configuration_service->RegisterConfigurationStoredHandler(nullptr);
    queue->Stop();
}
```

## src/management_controller.cpp
```c
#include <cstdint>
#include <memory>
#include <memory_resource>
#include <span>
#include <utility>
#include <vector>

#include <zephyr/sys/crc.h>
#include <zephyr/ztest.h>

#include "smp_test_client.h"

#include "subsys/threading/work_queue_thread.h"
#include "domain/configuration_domain/services/configuration_service.h"
#include "domain/configuration_domain/utilities/i_cbor_configuration_manager.h"

#include "controllers/management_controller.h"

using namespace smp_test;
using eerie_leap::controllers::ManagementController;
using eerie_leap::domain::configuration_domain::services::ConfigurationService;
using eerie_leap::domain::configuration_domain::utilities::ICborConfigurationManager;
using eerie_leap::domain::configuration_domain::utilities::StoredCborInfo;
using eerie_leap::subsys::threading::WorkQueueThread;

namespace {

constexpr int CONFIG_WORK_QUEUE_STACK_SIZE = 4096;
constexpr int CONFIG_WORK_QUEUE_PRIORITY = 10;
constexpr uint32_t BUILD_NUMBER = 4321;

class StoredConfigurationManager : public ICborConfigurationManager {
private:
    std::vector<uint8_t> stored_ = {0x80};

public:
    bool ApplyCborConfiguration(std::span<const uint8_t> cbor_data) override {
        stored_.assign(cbor_data.begin(), cbor_data.end());
        return true;
    }

    std::pmr::vector<uint8_t> GetCborConfiguration() override {
        return std::pmr::vector<uint8_t>(stored_.begin(), stored_.end());
    }

    StoredCborInfo GetCborConfigurationInfo() override {
        return {.size = stored_.size(), .crc = crc32_ieee(stored_.data(), stored_.size())};
    }
};

} // namespace

ZTEST_SUITE(management_controller, NULL, NULL, NULL, NULL, NULL);

ZTEST(management_controller, test_serves_the_config_and_device_groups) {
    auto work_queue = std::make_shared<WorkQueueThread>(
        "mgmt_test_config_wq", CONFIG_WORK_QUEUE_STACK_SIZE, CONFIG_WORK_QUEUE_PRIORITY);
    zassert_true(work_queue->Initialize());

    auto configuration_service = std::make_shared<ConfigurationService>();
    configuration_service->RegisterCborConfigurationManager(
        ConfigurationService::Type::Ui, std::make_shared<StoredConfigurationManager>());

    ManagementController controller(configuration_service, work_queue, nullptr, BUILD_NUMBER);
    zassert_equal(controller.Initialize(), 0);

    SmpTestClient client;

    const auto device = client.Read(SmpGroupId::DEVICE, 0);
    zassert_true(device.IsOk());
    zassert_equal(device.Value("build"), BUILD_NUMBER);
    zassert_false(device.Has("cdmp_id"), "No CDMP identity without network info");

    const auto types = client.Read(SmpGroupId::CONFIG, 0);
    zassert_true(types.IsOk());
    zassert_equal(types.entries.size(), 1);
    zassert_equal(types.entries[0].at("type"), std::to_underlying(ConfigurationService::Type::Ui));
}
```
