## CMakeLists.txt
```
cmake_minimum_required(VERSION 3.20.0)

set(RT_GAUGE_TEST_SIM_FLASH ON)
set(RT_GAUGE_TEST_LVGL ON)
include(${CMAKE_CURRENT_SOURCE_DIR}/../../rt_gauge_test.cmake)

# Use Zephyr's build system
find_package(Zephyr REQUIRED HINTS $ENV{ZEPHYR_BASE})
project(functional_views)

include(${RT_GAUGE_DIR}/cmake/lvgl_vector.cmake)
include(${RT_GAUGE_DIR}/cmake/builtin_fonts.cmake)

include_directories(${APP_SRC_DIR})

set(APP_SRC_CONFIGURATION_DIR ${APP_SRC_DIR}/configuration)
file(GLOB_RECURSE APP_SRC_CONFIGURATION
  ${APP_SRC_CONFIGURATION_DIR}/*.c
  ${APP_SRC_CONFIGURATION_DIR}/*.cpp
)

set(APP_SRC_UI_DOMAIN_DIR ${APP_SRC_DIR}/domain/ui_domain)
file(GLOB_RECURSE APP_SRC_UI_DOMAIN
  ${APP_SRC_UI_DOMAIN_DIR}/*.c
  ${APP_SRC_UI_DOMAIN_DIR}/*.cpp
)

# InitializeEventChannels() registers the channels widget bindings resolve through.
set(APP_SRC_EVENT_BUS_DIR ${APP_SRC_DIR}/event_bus)
file(GLOB_RECURSE APP_SRC_EVENT_BUS
  ${APP_SRC_EVENT_BUS_DIR}/*.c
  ${APP_SRC_EVENT_BUS_DIR}/*.cpp
)

set(APP_SRC_VIEWS_DIR ${APP_SRC_DIR}/views)
file(GLOB_RECURSE APP_SRC_VIEWS
  ${APP_SRC_VIEWS_DIR}/*.c
  ${APP_SRC_VIEWS_DIR}/*.cpp
)

# LottieWidget keeps ThorVG on the external heap.
set(APP_SRC_UTILITIES ${APP_SRC_DIR}/utilities/memory/scoped_new_resource.cpp)

file(GLOB_RECURSE TEST_SOURCES src/*.c src/*.cpp)
# The blend hook's test compiles only where the hook does: the compile databases the lint step merges keep the first
# entry of a file, and an entry from a build without the hook would hide the test's body from clang-tidy.
if(NOT CONFIG_LV_DRAW_SW_ASM_CUSTOM)
  list(FILTER TEST_SOURCES EXCLUDE REGEX "gauge_draw_sw\\.cpp$")
endif()

# Add all source files to the app target
target_sources(app PRIVATE
  ${APP_SRC_CONFIGURATION}
  ${APP_SRC_EVENT_BUS}
  ${APP_SRC_UI_DOMAIN}
  ${APP_SRC_UTILITIES}
  ${APP_SRC_VIEWS}
  ${TEST_SOURCES}
)

zephyr_link_libraries(-Wl,--wrap=lv_anim_start)

# A TrueType font small enough for the suite's heap, taken from the LVGL checkout so that no font binary lives here.
generate_inc_file_for_target(app ${ZEPHYR_LVGL_MODULE_DIR}/tests/src/test_assets/test_gpos_one.ttf
  ${ZEPHYR_BINARY_DIR}/include/generated/test_font_ttf.inc)
```

## Kconfig
```
menu "Zephyr"
source "Kconfig.zephyr"
endmenu

config EERIE_LEAP_HW_VERSION_MAJOR
	int "Hardware version major"
	range 0 255
	default 0

config EERIE_LEAP_HW_VERSION_MINOR
	int "Hardware version minor"
	range 0 255
	default 0

config EERIE_LEAP_HW_VERSION_PATCH
	int "Hardware version patch"
	range 0 65535
	default 0

config EERIE_LEAP_SW_VERSION_MAJOR
	int "Software version major"
	range 0 255
	default 0

config EERIE_LEAP_SW_VERSION_MINOR
	int "Software version minor"
	range 0 255
	default 0

config EERIE_LEAP_SW_VERSION_PATCH
	int "Software version patch"
	range 0 65535
	default 0

config EERIE_LEAP_UI_RENDERER_THREAD_STACK_SIZE
	int "UI renderer thread stack size"
	default 8192

config EERIE_LEAP_UI_ROTATION
	int
	default 0

config EERIE_LEAP_FLOAT_SIGNIFICANT_DIGITS
	int "Floating point significant digits"
	default 4

config EERIE_LEAP_FS_SD_THREAD_STACK_SIZE
	int "SD thread stack size"
	default 2048

config EERIE_LEAP_SD_CHECK_INTERVAL_MS
	int "SD check interval ms"
	default 1000

config EERIE_LEAP_UI_BUILTIN_FONTS
	bool "Built-in fonts"
	default y

config EERIE_LEAP_UI_FONT_GLYPH_CACHE_SIZE
	int "Glyph cache of one font size"
	default 131072
```

## prj.conf
```kconfig
CONFIG_ZTEST=y

#HW Version
CONFIG_EERIE_LEAP_HW_VERSION_MAJOR=2
CONFIG_EERIE_LEAP_HW_VERSION_MINOR=9
CONFIG_EERIE_LEAP_HW_VERSION_PATCH=6

#SW Version
CONFIG_EERIE_LEAP_SW_VERSION_MAJOR=7
CONFIG_EERIE_LEAP_SW_VERSION_MINOR=8
CONFIG_EERIE_LEAP_SW_VERSION_PATCH=4

# Language and Compiler
CONFIG_CPP=y
CONFIG_PICOLIBC=y
CONFIG_STD_CPP23=y
CONFIG_REQUIRES_FULL_LIBCPP=y
CONFIG_CPP_EXCEPTIONS=y
CONFIG_CPP_RTTI=y

# Memory
# Lottie frames are ARGB8888 buffers in the external heap, which is this pool off-device.
# Stay below 256 KB: a larger pool needs CONFIG_SYS_HEAP_AUTO or fails to init at boot.
CONFIG_HEAP_MEM_POOL_SIZE=196608

# C++ exception unwinding needs considerably more stack than the ztest defaults.
CONFIG_MAIN_STACK_SIZE=8192
CONFIG_ZTEST_STACK_SIZE=8192
CONFIG_STACK_SENTINEL=y
CONFIG_STACK_CANARIES=y

# Logging And Debugging
CONFIG_LOG=y
CONFIG_TEST_RANDOM_GENERATOR=y
CONFIG_THREAD_ANALYZER=y
CONFIG_THREAD_ANALYZER_USE_LOG=y
CONFIG_THREAD_RUNTIME_STATS=y
CONFIG_THREAD_NAME=y
CONFIG_SYS_HEAP_RUNTIME_STATS=y
CONFIG_THREAD_ANALYZER_ISR_STACK_USAGE=n

# FS Config
CONFIG_FLASH=y
CONFIG_FLASH_MAP=y
CONFIG_FILE_SYSTEM=y
CONFIG_FILE_SYSTEM_LITTLEFS=y
CONFIG_FILE_SYSTEM_MKFS=y

# CBOR
CONFIG_ZCBOR=y

# LVGL
CONFIG_LVGL=y
CONFIG_LV_Z_MEM_POOL_SIZE=131072
CONFIG_LV_USE_LOG=n
CONFIG_LV_USE_LABEL=y
CONFIG_LV_USE_IMAGE=y
CONFIG_LV_USE_VECTOR_GRAPHIC=y
CONFIG_LV_USE_CANVAS=y
CONFIG_LV_USE_THORVG=y
CONFIG_LV_USE_THORVG_INTERNAL=y
CONFIG_LV_USE_LOTTIE=y
CONFIG_LV_USE_SVG=y
CONFIG_LV_USE_SNAPSHOT=y
CONFIG_LV_USE_FONT_COMPRESSED=y
CONFIG_LV_FONT_MONTSERRAT_20=y
CONFIG_LV_FONT_DEFAULT_UNSCII_16=y
CONFIG_LV_USE_TINY_TTF=y
CONFIG_LV_TINY_TTF_FILE_SUPPORT=y

CONFIG_CRC=y
CONFIG_TIMING_FUNCTIONS=y

CONFIG_EERIE_LEAP_RT_CORE=y
CONFIG_EERIE_LEAP_ASSETS=y
CONFIG_EERIE_LEAP_CONFIGURATION=y
CONFIG_EERIE_LEAP_DEVICE_TREE=y
CONFIG_EERIE_LEAP_EVENT_BUS=y
CONFIG_EERIE_LEAP_FS=y
CONFIG_EERIE_LEAP_RANDOM=y
CONFIG_EERIE_LEAP_TIME=y
CONFIG_EERIE_LEAP_LUA_SCRIPT=y
CONFIG_EERIE_LEAP_EXPRESSION_ENGINE=y
```

## boards/qemu_cortex_a9.conf
```kconfig
# Zephyr maps the RAM image in 4 kB pages, then remaps each megabyte that is
# all code as a 1 MB section, asserting the L1 entry is unused though it holds
# an L2 table. This suite's code fills the megabyte at 0x200000, so the assert
# halts the board before the console exists. The section correctly replaces
# the table, so asserts are off. native_sim still runs the suite with asserts.
CONFIG_ASSERT=n
```

## src/font_cache.cpp
```c
#include <algorithm>
#include <array>
#include <cstdint>
#include <memory>
#include <optional>
#include <span>
#include <string_view>

#include <lvgl.h>
#include <lvgl_mem.h>
#include <zephyr/ztest.h>

#include "domain/ui_domain/lvgl_lock.h"
#include "subsys/assets/asset_kind.h"
#include "subsys/assets/asset_provider.h"
#include "subsys/assets/assets_manager.h"
#include "views/assets/fonts/builtin_fonts.h"
#include "views/utilities/font_cache.h"

#include "views_test_support.h"

using eerie_leap::domain::ui_domain::ScopedLvglLock;
using eerie_leap::subsys::assets::AssetKind;
using eerie_leap::subsys::assets::BuiltInAsset;
using eerie_leap::views::assets::BuiltInFonts;
using eerie_leap::views::utilities::FontCache;
using eerie_leap::views::utilities::LvglFont;

namespace {

// The font fixture, embedded at build time (see this suite's CMakeLists.txt).
const uint8_t TEST_FONT_TTF[] = {
#include "test_font_ttf.inc"
};

constexpr uint32_t CJK_CHARACTER = 0x4E2D; // the test font has Latin letters only

std::shared_ptr<eerie_leap::subsys::assets::AssetStore> FontStore() {
    auto store = views_test::MakeAssetStore("ui_assets/fonts");
    zassert_true(store->Save("test.ttf", TEST_FONT_TTF));
    zassert_true(store->Save("bad.ttf", views_test::TextBytes("this is not a font, but it is long enough to read")));
    return store;
}

std::shared_ptr<FontCache> MakeCache() {
    return std::make_shared<FontCache>(views_test::MakeAssetsManager(AssetKind::FONTS, FontStore()));
}

bool HasGlyph(const lv_font_t* font, uint32_t character) {
    lv_font_glyph_dsc_t glyph;
    return lv_font_get_glyph_dsc(font, &glyph, character, 0);
}

lv_obj_t* DrawLabel(const LvglFont& font) {
    auto* label = lv_label_create(lv_screen_active());
    lv_obj_set_style_text_font(label, font.ToLvFont(), LV_PART_MAIN);
    font.BindTo(label);
    lv_label_set_text(label, "Aa Gg");
    lv_refr_now(nullptr);
    return label;
}

size_t LvglHeapBytes() {
    sys_memory_stats stats{};
    lvgl_heap_stats(&stats);
    return stats.allocated_bytes;
}

void* Setup() {
    views_test::EnsureTestDisplay();
    return nullptr;
}

} // namespace

ZTEST_SUITE(font_cache, NULL, Setup, NULL, views_test::CleanTestDisplay, NULL);

ZTEST(font_cache, test_a_font_loads_at_its_size) {
    const ScopedLvglLock lock;
    auto cache = MakeCache();

    auto font = cache->Acquire("test.ttf", 24);
    zassert_true(font.has_value());
    const int32_t line_height = lv_font_get_line_height(font->ToLvFont());
    zassert_true(line_height >= 24 && line_height <= 48, "line height %d", line_height);
    zassert_true(HasGlyph(font->ToLvFont(), 'A'));
    zassert_false(HasGlyph(font->ToLvFont(), CJK_CHARACTER));
}

ZTEST(font_cache, test_a_name_and_size_share_one_font) {
    const ScopedLvglLock lock;
    auto cache = MakeCache();

    auto first = cache->Acquire("test.ttf", 24);
    auto second = cache->Acquire("test.ttf", 24);
    auto large = cache->Acquire("test.ttf", 48);
    zassert_true(first && second && large);
    zassert_equal(first->ToLvFont(), second->ToLvFont());
    zassert_not_equal(first->ToLvFont(), large->ToLvFont());
    zassert_true(lv_font_get_line_height(large->ToLvFont()) > lv_font_get_line_height(first->ToLvFont()));
}

ZTEST(font_cache, test_what_cannot_load_gives_nothing) {
    const ScopedLvglLock lock;
    auto cache = MakeCache();

    zassert_false(cache->Acquire("missing.ttf", 24).has_value());
    zassert_false(cache->Acquire("bad.ttf", 24).has_value());
    zassert_false(cache->Acquire("test.ttf", 7).has_value());
    zassert_false(cache->Acquire("test.ttf", 257).has_value());
    zassert_false(cache->Acquire("", 24).has_value());
}

ZTEST(font_cache, test_a_unit_without_fonts_gives_nothing) {
    const ScopedLvglLock lock;

    FontCache images_only(views_test::MakeAssetsManager(AssetKind::IMAGES, FontStore()));
    zassert_false(images_only.Acquire("test.ttf", 24).has_value());

    FontCache no_manager(nullptr);
    zassert_false(no_manager.Acquire("test.ttf", 24).has_value());
}

ZTEST(font_cache, test_an_upload_changes_what_the_next_acquire_loads) {
    const ScopedLvglLock lock;
    auto store = FontStore();
    FontCache cache(views_test::MakeAssetsManager(AssetKind::FONTS, store));

    auto before = cache.Acquire("test.ttf", 24);
    zassert_true(before.has_value());
    const lv_font_t* before_font = before->ToLvFont();
    const int32_t before_height = lv_font_get_line_height(before_font);

    zassert_true(store->Save("test.ttf", TEST_FONT_TTF));
    auto after = cache.Acquire("test.ttf", 24);
    zassert_true(after.has_value());
    zassert_not_equal(after->ToLvFont(), before_font);

    zassert_equal(before->ToLvFont(), before_font);
    zassert_equal(lv_font_get_line_height(before_font), before_height);
    zassert_true(HasGlyph(before_font, 'A'));
}

ZTEST(font_cache, test_deleting_the_labels_returns_the_memory) {
    const ScopedLvglLock lock;
    auto cache = MakeCache();

    // LVGL's own caches fill on the first draw; start from there.
    lv_obj_delete(DrawLabel(LvglFont{ &lv_font_montserrat_20 }));
    const size_t baseline = LvglHeapBytes();

    auto small = cache->Acquire("test.ttf", 24);
    auto large = cache->Acquire("test.ttf", 48);
    zassert_true(small && large);
    auto* small_label = DrawLabel(*small);
    auto* large_label = DrawLabel(*large);
    zassert_true(LvglHeapBytes() > baseline);

    lv_obj_delete(small_label);
    lv_obj_delete(large_label);
    small.reset();
    large.reset();
    zassert_equal(LvglHeapBytes(), baseline);
}

#ifdef CONFIG_EERIE_LEAP_UI_BUILTIN_FONTS

namespace {

constexpr int32_t BUILT_IN_SIZE_PX = 40;
// Large enough that a kerning of a few percent of an em is whole pixels.
constexpr int32_t BIG_SIZE_PX = 200;
// What a client may upload as a font (EERIE_LEAP_UI_FONT_MAX_SIZE): a built-in must not be larger.
constexpr size_t FONT_UPLOAD_LIMIT = 256 * 1024;
constexpr uint32_t E_ACUTE = 0x00E9;
constexpr uint32_t NO_BREAK_SPACE = 0x00A0;
// A TrueType file starts with this version.
constexpr std::array<uint8_t, 4> TRUETYPE_VERSION = { 0x00, 0x01, 0x00, 0x00 };

// A registry as the unit has it: the built-in fonts, and a store that holds no font at all.
std::shared_ptr<eerie_leap::subsys::assets::AssetsManager> BuiltInFontsManager(
    std::shared_ptr<eerie_leap::subsys::assets::AssetStore> store = views_test::MakeAssetStore("ui_assets/no_fonts")
) {
    return views_test::MakeAssetsManager(AssetKind::FONTS, std::move(store), BuiltInFonts());
}

// Whether the sfnt font has a table of this tag (the table directory follows the 12-byte header, 16 bytes a record).
bool HasTable(std::span<const uint8_t> font, std::string_view tag) {
    constexpr size_t HEADER_SIZE = 12;
    constexpr size_t RECORD_SIZE = 16;
    constexpr size_t TAG_SIZE = 4;

    const size_t count = (static_cast<size_t>(font[4]) << 8) | font[5];
    for(size_t i = 0; i < count; ++i) {
        const auto record = font.subspan(HEADER_SIZE + i * RECORD_SIZE, TAG_SIZE);
        if(std::ranges::equal(record, tag))
            return true;
    }

    return false;
}

} // namespace

ZTEST(font_cache, test_the_built_in_fonts_are_the_three_latin_1_subsets) {
    const auto built_ins = BuiltInFonts();

    zassert_equal(built_ins.size(), 3U);
    zassert_true(built_ins[0].name == "Rubik-Medium.ttf");
    zassert_true(built_ins[1].name == "Montserrat-Medium.ttf");
    zassert_true(built_ins[2].name == "Inconsolata-Bold.ttf");

    for(const BuiltInAsset& built_in : built_ins) {
        zassert_true(
            built_in.data.size() > TRUETYPE_VERSION.size(), "%.*s", static_cast<int>(built_in.name.size()),
            built_in.name.data()
        );
        zassert_true(
            std::equal(TRUETYPE_VERSION.begin(), TRUETYPE_VERSION.end(), built_in.data.begin()),
            "%.*s is no TrueType file", static_cast<int>(built_in.name.size()), built_in.name.data()
        );
        zassert_true(
            built_in.data.size() <= FONT_UPLOAD_LIMIT, "%.*s is bigger than a font may be",
            static_cast<int>(built_in.name.size()), built_in.name.data()
        );
    }
}

ZTEST(font_cache, test_a_built_in_font_loads_from_flash_with_no_copy_and_no_store_read) {
    const ScopedLvglLock lock;
    // The store has no file of any name: whatever loads is not from it.
    auto cache = std::make_shared<FontCache>(BuiltInFontsManager());

    for(const BuiltInAsset& built_in : BuiltInFonts()) {
        auto font = cache->Acquire(built_in.name, BUILT_IN_SIZE_PX);

        zassert_true(font.has_value(), "%.*s", static_cast<int>(built_in.name.size()), built_in.name.data());
        zassert_true(HasGlyph(font->ToLvFont(), 'A'));
        zassert_true(HasGlyph(font->ToLvFont(), E_ACUTE), "Latin-1 letters are in the subset");
        zassert_true(HasGlyph(font->ToLvFont(), NO_BREAK_SPACE));
        zassert_false(HasGlyph(font->ToLvFont(), CJK_CHARACTER));
        zassert_true(lv_font_get_line_height(font->ToLvFont()) >= BUILT_IN_SIZE_PX);
        zassert_equal(cache->GetCopiedBytes(), 0U, "A built-in is read in place, not copied to RAM");

        lv_obj_delete(DrawLabel(*font));
    }
}

ZTEST(font_cache, test_a_built_in_font_at_one_size_is_shared_and_other_sizes_are_other_fonts) {
    const ScopedLvglLock lock;
    auto store = views_test::MakeAssetStore("ui_assets/no_fonts");
    auto cache = std::make_shared<FontCache>(BuiltInFontsManager(store));

    auto first = cache->Acquire("Rubik-Medium.ttf", BUILT_IN_SIZE_PX);
    auto second = cache->Acquire("rubik-medium.ttf", BUILT_IN_SIZE_PX);
    auto large = cache->Acquire("Rubik-Medium.ttf", 2 * BUILT_IN_SIZE_PX);
    zassert_true(first && second && large);
    zassert_equal(first->ToLvFont(), second->ToLvFont(), "Names compare ignoring case, as the assets group's do");
    zassert_not_equal(first->ToLvFont(), large->ToLvFont());

    // A write in the kind changes the store's generation, not the flash.
    zassert_true(store->Save("test.ttf", TEST_FONT_TTF));
    auto after = cache->Acquire("Rubik-Medium.ttf", BUILT_IN_SIZE_PX);
    zassert_true(after.has_value());
    zassert_equal(after->ToLvFont(), first->ToLvFont());
    zassert_true(store->Delete("test.ttf"));
}

ZTEST(font_cache, test_a_built_in_wins_over_a_stored_file_of_its_name) {
    const ScopedLvglLock lock;
    auto store = views_test::MakeAssetStore("ui_assets/shadowed_fonts");
    zassert_true(
        store->Save("Rubik-Medium.ttf", views_test::TextBytes("this is not a font, but it is long enough to read"))
    );
    auto cache = std::make_shared<FontCache>(BuiltInFontsManager(store));

    auto font = cache->Acquire("Rubik-Medium.ttf", BUILT_IN_SIZE_PX);

    zassert_true(font.has_value(), "The stored file is no font; the built-in is what loads");
    zassert_true(HasGlyph(font->ToLvFont(), 'A'));
    zassert_equal(cache->GetCopiedBytes(), 0U);
    zassert_true(store->Delete("Rubik-Medium.ttf"));
}

ZTEST(font_cache, test_an_uploaded_font_still_loads_beside_the_built_ins) {
    const ScopedLvglLock lock;
    auto cache = std::make_shared<FontCache>(BuiltInFontsManager(FontStore()));

    auto uploaded = cache->Acquire("test.ttf", 24);

    zassert_true(uploaded.has_value());
    zassert_equal(cache->GetCopiedBytes(), sizeof(TEST_FONT_TTF), "An uploaded file is copied to RAM, once");
    zassert_false(cache->Acquire("missing.ttf", 24).has_value());
}

ZTEST(font_cache, test_deleting_the_labels_of_a_built_in_returns_the_memory) {
    const ScopedLvglLock lock;
    auto cache = std::make_shared<FontCache>(BuiltInFontsManager());

    lv_obj_delete(DrawLabel(LvglFont{ &lv_font_montserrat_20 }));
    const size_t baseline = LvglHeapBytes();

    auto font = cache->Acquire("Montserrat-Medium.ttf", BUILT_IN_SIZE_PX);
    zassert_true(font.has_value());
    auto* label = DrawLabel(*font);
    zassert_true(LvglHeapBytes() > baseline);

    lv_obj_delete(label);
    font.reset();
    zassert_equal(LvglHeapBytes(), baseline);
}

// stb_truetype, which Tiny TTF draws with, reads kerning from a `kern` table, and from GPOS only in a narrow form: the
// built-in fonts carry their kerning as a `kern` table and no GPOS (see builtin/make_fonts.py).
ZTEST(font_cache, test_the_built_in_fonts_carry_their_kerning_in_a_kern_table_and_no_gpos) {
    for(const BuiltInAsset& built_in : BuiltInFonts()) {
        zassert_false(
            HasTable(built_in.data, "GPOS"), "%.*s", static_cast<int>(built_in.name.size()), built_in.name.data()
        );
        // Monospace Inconsolata has no kerned pair, so no table.
        zassert_equal(
            HasTable(built_in.data, "kern"), built_in.name != "Inconsolata-Bold.ttf", "%.*s",
            static_cast<int>(built_in.name.size()), built_in.name.data()
        );
    }
}

ZTEST(font_cache, test_a_kerned_pair_of_a_built_in_font_is_narrower_through_tiny_ttf) {
    const ScopedLvglLock lock;
    auto cache = std::make_shared<FontCache>(BuiltInFontsManager());

    for(const auto* const name : { "Rubik-Medium.ttf", "Montserrat-Medium.ttf" }) {
        auto font = cache->Acquire(name, BIG_SIZE_PX);
        zassert_true(font.has_value(), "%s", name);

        // The advance of 'A' with kerning against a letter it is kerned with, and against a space, which it is not.
        lv_font_glyph_dsc_t kerned{};
        lv_font_glyph_dsc_t plain{};
        zassert_true(lv_font_get_glyph_dsc(font->ToLvFont(), &kerned, 'A', 'V'), "%s", name);
        zassert_true(lv_font_get_glyph_dsc(font->ToLvFont(), &plain, 'A', ' '), "%s", name);

        zassert_true(
            kerned.adv_w < plain.adv_w, "%s: AV advances %d, A and a space %d", name, kerned.adv_w, plain.adv_w
        );
    }
}

#endif // CONFIG_EERIE_LEAP_UI_BUILTIN_FONTS
```

## src/gauge_draw_sw.cpp
```c
// The gauge's LVGL blend hook (lvgl_hooks/gauge_draw_sw.c): an opaque RGB565 image copied into an
// RGB565_SWAPPED buffer in one pass. The hook is built only with CONFIG_LV_DRAW_SW_ASM_CUSTOM, so the cases
// below exist only in the scenario that turns it on.
#include <zephyr/ztest.h>

#include <lvgl.h>

#ifdef CONFIG_LV_DRAW_SW_ASM_CUSTOM

    #include <algorithm>
    #include <bit>
    #include <cmath>
    #include <cstdint>
    #include <cstdlib>
    #include <cstring>
    #include <functional>
    #include <vector>

extern "C" {
    #include <lvgl_hooks/gauge_draw_sw.h>
    #include <lvgl_private.h>
}

    #include "views_test_support.h"

namespace {

// The hook and the panels work on bytes of memory and on 16-bit pixels: the only casts between the views.
uint8_t* AsBytes(void* p) {
    return static_cast<uint8_t*>(p);
}

uint16_t* AsPixels(void* p) {
    return static_cast<uint16_t*>(p);
}

const uint16_t* AsPixels(const void* p) {
    return static_cast<const uint16_t*>(p);
}

constexpr uint8_t GUARD = 0xA5;
constexpr size_t MARGIN = 16;

uint8_t SourceByte(size_t i) {
    return static_cast<uint8_t>(i * 37U + 11U);
}

// Runs the hook on a source at byte offset src_off and a destination at dst_off, then compares every byte
// of the destination buffer, guards included, with what lv_memcpy + lv_draw_rgb565_swap leaves.
void CheckBlend(int32_t w, int32_t h, size_t src_off, size_t dst_off, int32_t src_extra, int32_t dst_extra) {
    const int32_t src_stride = w * 2 + src_extra;
    const int32_t dst_stride = w * 2 + dst_extra;
    // Backing store of 4-byte alignment, so an offset is the pointer's real offset modulo 4.
    std::vector<uint32_t> src_store((MARGIN + src_stride * h + 16) / 4 + 1);
    std::vector<uint32_t> dst_store((MARGIN + dst_stride * h + 16) / 4 + 1);
    std::vector<uint32_t> ref_store(dst_store.size());
    auto* src_base = AsBytes(src_store.data());
    auto* dst_base = AsBytes(dst_store.data());
    auto* ref_base = AsBytes(ref_store.data());
    const size_t dst_bytes = dst_store.size() * 4;

    for(size_t i = 0; i < src_store.size() * 4; ++i) {
        src_base[i] = SourceByte(i);
    }
    std::memset(dst_base, GUARD, dst_bytes);
    std::memset(ref_base, GUARD, dst_bytes);

    const uint8_t* src = src_base + MARGIN + src_off;
    uint8_t* dst = dst_base + MARGIN + dst_off;
    uint8_t* ref = ref_base + MARGIN + dst_off;

    for(int32_t y = 0; y < h; ++y) {
        lv_memcpy(ref + y * dst_stride, src + y * src_stride, static_cast<size_t>(w) * 2);
        lv_draw_rgb565_swap(ref + y * dst_stride, static_cast<uint32_t>(w));
    }

    _lv_draw_sw_blend_image_dsc_t dsc{};
    dsc.dest_buf = dst;
    dsc.dest_w = w;
    dsc.dest_h = h;
    dsc.dest_stride = dst_stride;
    dsc.src_buf = src;
    dsc.src_stride = src_stride;
    dsc.src_color_format = LV_COLOR_FORMAT_RGB565;
    dsc.opa = LV_OPA_COVER;
    dsc.blend_mode = LV_BLEND_MODE_NORMAL;

    zassert_equal(gauge_blend_rgb565_to_rgb565_swapped(&dsc), LV_RESULT_OK);
    for(size_t i = 0; i < dst_bytes; ++i) {
        if(dst_base[i] != ref_base[i]) {
            zassert_true(
                false, "w %d h %d src_off %u dst_off %u src_extra %d dst_extra %d: byte %u is 0x%02x, expected 0x%02x",
                (int)w, (int)h, (unsigned)src_off, (unsigned)dst_off, (int)src_extra, (int)dst_extra, (unsigned)i,
                dst_base[i], ref_base[i]
            );
        }
    }
}

} // namespace

ZTEST(gauge_draw_sw, test_hook_matches_memcpy_and_swap_for_every_alignment_and_size) {
    constexpr int32_t WIDTHS[] = { 1, 2, 3, 15, 16, 17, 466 };
    constexpr int32_t HEIGHTS[] = { 1, 7 };
    for(const int32_t w : WIDTHS) {
        for(const int32_t h : HEIGHTS) {
            for(size_t src_off = 0; src_off < 4; ++src_off) {
                for(size_t dst_off = 0; dst_off < 4; ++dst_off) {
                    CheckBlend(w, h, src_off, dst_off, 0, 0);
                    // Strides wider than the row, in bytes; 6 keeps the row start phase changing per row.
                    CheckBlend(w, h, src_off, dst_off, 8, 8);
                    CheckBlend(w, h, src_off, dst_off, 0, 6);
                    CheckBlend(w, h, src_off, dst_off, 6, 0);
                }
            }
        }
    }
}

ZTEST(gauge_draw_sw, test_rgb565_image_reaches_a_swapped_canvas_as_big_endian) {
    views_test::EnsureTestDisplay();

    constexpr int32_t W = 17;
    constexpr int32_t H = 5;
    constexpr int32_t X = 1; // an odd pixel column: the destination row starts on a 2-byte phase
    std::vector<uint16_t> pixels(W * H);
    for(size_t i = 0; i < pixels.size(); ++i) {
        pixels[i] = static_cast<uint16_t>(0x1234U + i * 0x0111U);
    }
    lv_image_dsc_t image{};
    image.header.magic = LV_IMAGE_HEADER_MAGIC;
    image.header.cf = LV_COLOR_FORMAT_RGB565;
    image.header.w = W;
    image.header.h = H;
    image.header.stride = W * 2;
    image.data_size = pixels.size() * 2;
    image.data = AsBytes(pixels.data());

    constexpr int32_t CANVAS_W = 24;
    constexpr int32_t CANVAS_H = 8;
    lv_draw_buf_t* buf = lv_draw_buf_create(CANVAS_W, CANVAS_H, LV_COLOR_FORMAT_RGB565_SWAPPED, 0);
    zassert_not_null(buf);
    lv_obj_t* canvas = lv_canvas_create(lv_screen_active());
    lv_canvas_set_draw_buf(canvas, buf);
    lv_canvas_fill_bg(canvas, lv_color_black(), LV_OPA_COVER);

    lv_layer_t layer;
    lv_canvas_init_layer(canvas, &layer);
    lv_draw_image_dsc_t dsc;
    lv_draw_image_dsc_init(&dsc);
    dsc.src = &image;
    const lv_area_t area = { X, 1, X + W - 1, H };
    lv_draw_image(&layer, &dsc, &area);
    lv_canvas_finish_layer(canvas, &layer);

    for(int32_t y = 0; y < H; ++y) {
        const uint8_t* row = static_cast<const uint8_t*>(lv_draw_buf_goto_xy(buf, 0, 1 + y));
        for(int32_t x = 0; x < W; ++x) {
            const uint16_t expected = pixels[y * W + x];
            zassert_equal(row[(X + x) * 2], expected >> 8, "high byte at %d,%d", (int)x, (int)y);
            zassert_equal(row[(X + x) * 2 + 1], expected & 0xFF, "low byte at %d,%d", (int)x, (int)y);
        }
    }

    lv_obj_delete(canvas);
    lv_draw_buf_destroy(buf);
}

    #ifdef CONFIG_GAUGE_ROUND_PANEL_CLIP

namespace {

// The round panel's corner skip (CONFIG_GAUGE_ROUND_PANEL_CLIP): checked on a real display of the S3's size.
constexpr int32_t PANEL = 466;
constexpr int32_t MARGIN_PX = CONFIG_GAUGE_ROUND_PANEL_CLIP_MARGIN_PX;
constexpr size_t FRAME_BYTES = static_cast<size_t>(PANEL) * PANEL * 2 + 128;

alignas(64) uint8_t frame_store[FRAME_BYTES];
alignas(64) uint8_t other_store[FRAME_BYTES];
uint16_t image_pixels[PANEL * PANEL];

constexpr uint16_t SENTINEL = 0xA55A; // not byte-symmetric, so a swapped sentinel differs from it

uint16_t Swap16(uint16_t v) {
    return std::rotl(v, 8);
}

// RGB565 source pixel; its high byte is always 0x12 so a swapped copy never looks like the sentinel.
uint16_t SourcePixel(int32_t x, int32_t y) {
    return static_cast<uint16_t>(0x1200U | ((x * 5 + y * 3) & 0xFFU));
}

void FillSource() {
    for(int32_t y = 0; y < PANEL; ++y) {
        for(int32_t x = 0; x < PANEL; ++x) {
            image_pixels[y * PANEL + x] = SourcePixel(x, y);
        }
    }
}

void FlushIgnore(lv_display_t* disp, const lv_area_t* /*area*/, uint8_t* /*px_map*/) {
    lv_display_flush_ready(disp);
}

lv_display_t* CreatePanel(uint8_t* second = nullptr) {
    lv_display_t* disp = lv_display_create(PANEL, PANEL);
    zassert_not_null(disp);
    lv_display_set_color_format(disp, LV_COLOR_FORMAT_RGB565_SWAPPED);
    lv_display_set_buffers(disp, frame_store, second, sizeof(frame_store), LV_DISPLAY_RENDER_MODE_FULL);
    lv_display_set_flush_cb(disp, FlushIgnore);
    zassert_not_null(disp->buf_act);
    return disp;
}

void FillFrame(lv_display_t* disp, uint16_t value) {
    const lv_draw_buf_t* buf = disp->buf_act;
    for(int32_t y = 0; y < PANEL; ++y) {
        auto* row = AsPixels(buf->data + static_cast<size_t>(y) * buf->header.stride);
        for(int32_t x = 0; x < PANEL; ++x) {
            row[x] = value;
        }
    }
}

// The test's own idea of the pixels a circle inscribed in the PANEL square touches: the pixel's square
// [x, x + 1] x [y, y + 1] has a point nearer than the radius to the centre.
bool TouchesCircle(int32_t x, int32_t y) {
    const double centre = PANEL / 2.0;
    auto nearest = [centre](int32_t p) {
        const double d = std::fabs(p + 0.5 - centre) - 0.5;
        return d > 0 ? d : 0.0;
    };
    const double dx = nearest(x);
    const double dy = nearest(y);
    return dx * dx + dy * dy < centre * centre;
}

// Where the test expects the clipped copy to start in row y: the smallest half-chord in whole pixels that
// covers the row's nearest edge, plus the margin, found by search.
int32_t ExpectedFrom(int32_t y) {
    const int32_t a = std::abs(2 * y + 1 - PANEL);
    const int32_t e = a > 1 ? a - 1 : 0;
    const int32_t v = PANEL * PANEL - e * e;
    int32_t k = 0;
    while(v > 0 && 4 * k * k < v) {
        ++k;
    }
    return std::max<int32_t>(0, (PANEL - 2 * (k + MARGIN_PX)) / 2);
}

struct Rows {
    const uint8_t* data;
    int32_t stride;
    uint16_t At(int32_t x, int32_t y) const {
        return *AsPixels(data + static_cast<size_t>(y) * stride + static_cast<size_t>(x) * 2);
    }
};

// clipped: the copy skipped the corners. Otherwise the first `copied_w` pixels of every row were copied.
void CheckFrame(
    const Rows& rows,
    const std::function<uint16_t(int32_t, int32_t)>& expected,
    bool clipped,
    int32_t copied_w
) {
    for(int32_t y = 0; y < PANEL; ++y) {
        const int32_t from = clipped ? ExpectedFrom(y) : 0;
        const int32_t end = clipped ? PANEL - from : copied_w;
        for(int32_t x = 0; x < PANEL; ++x) {
            const uint16_t got = rows.At(x, y);
            if(x >= from && x < end) {
                zassert_equal(got, expected(x, y), "pixel %d,%d is 0x%04x", (int)x, (int)y, (unsigned)got);
            } else if(clipped) {
                zassert_false(TouchesCircle(x, y), "visible pixel %d,%d outside the copied range", (int)x, (int)y);
                zassert_equal(got, SENTINEL, "pixel %d,%d outside the chord was written", (int)x, (int)y);
            } else {
                zassert_equal(got, SENTINEL, "pixel %d,%d beyond the copied width was written", (int)x, (int)y);
            }
        }
    }
}

void CallHook(
    uint8_t* dest,
    int32_t stride,
    int32_t w,
    int32_t h,
    int32_t x1,
    const uint8_t* src = AsBytes(image_pixels)
) {
    _lv_draw_sw_blend_image_dsc_t dsc{};
    dsc.dest_buf = dest;
    dsc.dest_w = w;
    dsc.dest_h = h;
    dsc.dest_stride = stride;
    dsc.relative_area = { x1, 0, x1 + w - 1, h - 1 };
    dsc.src_buf = src;
    dsc.src_stride = PANEL * 2;
    dsc.src_color_format = LV_COLOR_FORMAT_RGB565;
    dsc.opa = LV_OPA_COVER;
    dsc.blend_mode = LV_BLEND_MODE_NORMAL;
    zassert_equal(gauge_blend_rgb565_to_rgb565_swapped(&dsc), LV_RESULT_OK);
}

uint16_t SwappedSource(int32_t x, int32_t y) {
    return Swap16(SourcePixel(x, y));
}

void FillBytes(uint8_t* base, size_t bytes) {
    for(size_t i = 0; i + 1 < bytes; i += 2) {
        *AsPixels(base + i) = SENTINEL;
    }
}

} // namespace

ZTEST(gauge_draw_sw, test_full_frame_blit_skips_only_the_corners_and_other_blits_copy_everything) {
    views_test::EnsureTestDisplay();
    FillSource();
    lv_display_t* disp = CreatePanel();
    const auto stride = static_cast<int32_t>(disp->buf_act->header.stride);
    uint8_t* frame = disp->buf_act->data;

    // All five conditions hold.
    FillFrame(disp, SENTINEL);
    lv_refr_set_disp_refreshing(disp);
    CallHook(frame, stride, PANEL, PANEL, 0);
    CheckFrame({ frame, stride }, SwappedSource, true, PANEL);

    // Each broken in turn: every pixel of every row is copied.
    FillFrame(disp, SENTINEL);
    FillBytes(other_store, sizeof(other_store));
    {
        auto* other = &other_store[0];
        // Not the active buffer (same size): the stride of the buffer the display made, 64-aligned.
        CallHook(other, stride, PANEL, PANEL, 0);
        CheckFrame({ other, stride }, SwappedSource, false, PANEL);
    }

    FillFrame(disp, SENTINEL);
    CallHook(frame, stride, PANEL, PANEL, 1); // relative_area not at the origin
    CheckFrame({ frame, stride }, SwappedSource, false, PANEL);

    FillFrame(disp, SENTINEL);
    CallHook(frame, stride, PANEL - 1, PANEL, 0); // narrower
    CheckFrame({ frame, stride }, SwappedSource, false, PANEL - 1);

    FillFrame(disp, SENTINEL);
    CallHook(frame, stride, PANEL, PANEL - 1, 0); // shorter: the last row stays
    for(int32_t x = 0; x < PANEL; ++x) {
        zassert_equal(Rows({ frame, stride }).At(x, PANEL - 1), SENTINEL);
    }
    {
        // Rows 0..PANEL-2 were copied whole.
        const Rows rows{ frame, stride };
        for(int32_t y = 0; y < PANEL - 1; ++y) {
            for(int32_t x = 0; x < PANEL; ++x) {
                zassert_equal(rows.At(x, y), SwappedSource(x, y), "pixel %d,%d", (int)x, (int)y);
            }
        }
    }

    FillFrame(disp, SENTINEL);
    lv_display_set_rotation(disp, LV_DISPLAY_ROTATION_90);
    CallHook(frame, stride, PANEL, PANEL, 0);
    lv_display_set_rotation(disp, LV_DISPLAY_ROTATION_0);
    CheckFrame({ frame, stride }, SwappedSource, false, PANEL);

    FillFrame(disp, SENTINEL);
    lv_refr_set_disp_refreshing(nullptr);
    CallHook(frame, stride, PANEL, PANEL, 0);
    CheckFrame({ frame, stride }, SwappedSource, false, PANEL);

    lv_refr_set_disp_refreshing(nullptr);
    lv_display_delete(disp);
}

ZTEST(gauge_draw_sw, test_a_full_screen_image_refresh_leaves_the_corners_alone) {
    views_test::EnsureTestDisplay();
    FillSource();
    lv_display_t* disp = CreatePanel();

    lv_image_dsc_t image{};
    image.header.magic = LV_IMAGE_HEADER_MAGIC;
    image.header.cf = LV_COLOR_FORMAT_RGB565;
    image.header.w = PANEL;
    image.header.h = PANEL;
    image.header.stride = PANEL * 2;
    image.data_size = sizeof(image_pixels);
    image.data = AsBytes(image_pixels);

    lv_obj_t* screen = lv_display_get_screen_active(disp);
    lv_obj_set_style_bg_opa(screen, LV_OPA_TRANSP, 0);
    lv_obj_t* img = lv_image_create(screen);
    lv_image_set_src(img, &image);
    lv_obj_set_pos(img, 0, 0);

    FillFrame(disp, SENTINEL);
    lv_refr_now(disp);

    const lv_draw_buf_t* buf = disp->buf_act;
    CheckFrame({ buf->data, static_cast<int32_t>(buf->header.stride) }, SwappedSource, true, PANEL);

    lv_obj_delete(img);
    lv_display_delete(disp);
}

// The clipped copy on the fallback path: the source starts 1 byte (odd address) or 2 bytes (other 4-byte
// phase than the destination) off, so the row is copied by lv_memcpy and lv_draw_rgb565_swap.
ZTEST(gauge_draw_sw, test_the_clipped_copy_is_exact_on_the_fallback_path) {
    views_test::EnsureTestDisplay();
    lv_display_t* disp = CreatePanel();
    const auto stride = static_cast<int32_t>(disp->buf_act->header.stride);
    uint8_t* frame = disp->buf_act->data;
    alignas(4) static uint8_t src_store[PANEL * PANEL * 2 + 8];

    for(const size_t offset : { 1U, 2U }) {
        for(int32_t y = 0; y < PANEL; ++y) {
            for(int32_t x = 0; x < PANEL; ++x) {
                const uint16_t px = SourcePixel(x, y);
                memcpy(src_store + offset + (static_cast<size_t>(y) * PANEL + x) * 2, &px, sizeof(px));
            }
        }
        FillFrame(disp, SENTINEL);
        lv_refr_set_disp_refreshing(disp);
        CallHook(frame, stride, PANEL, PANEL, 0, src_store + offset);
        lv_refr_set_disp_refreshing(nullptr);
        CheckFrame({ frame, stride }, SwappedSource, true, PANEL);
    }
    lv_display_delete(disp);
}

// The S3 renders into two buffers in turn: the corner skip must hold for the one that is not the first.
ZTEST(gauge_draw_sw, test_the_corners_are_skipped_in_both_buffers_of_a_double_buffered_panel) {
    views_test::EnsureTestDisplay();
    FillSource();
    lv_display_t* disp = CreatePanel(other_store);

    lv_image_dsc_t image{};
    image.header.magic = LV_IMAGE_HEADER_MAGIC;
    image.header.cf = LV_COLOR_FORMAT_RGB565;
    image.header.w = PANEL;
    image.header.h = PANEL;
    image.header.stride = PANEL * 2;
    image.data_size = sizeof(image_pixels);
    image.data = AsBytes(image_pixels);

    lv_obj_t* screen = lv_display_get_screen_active(disp);
    lv_obj_set_style_bg_opa(screen, LV_OPA_TRANSP, 0);
    lv_obj_t* img = lv_image_create(screen);
    lv_image_set_src(img, &image);
    lv_obj_set_pos(img, 0, 0);

    const uint8_t* seen[4] = {};
    for(const uint8_t*& frame : seen) {
        // Both buffers start as sentinel; the refresh renders into one of them.
        FillBytes(frame_store, sizeof(frame_store));
        FillBytes(other_store, sizeof(other_store));
        lv_obj_invalidate(screen);
        lv_refr_now(disp);
        const lv_draw_buf_t* target = disp->buf_1;
        if(Rows({ target->data, static_cast<int32_t>(target->header.stride) }).At(PANEL / 2, PANEL / 2) == SENTINEL) {
            target = disp->buf_2;
        }
        frame = target->data;
        CheckFrame({ target->data, static_cast<int32_t>(target->header.stride) }, SwappedSource, true, PANEL);
    }
    zassert_not_equal(seen[0], seen[1], "the panel did not alternate its buffers");

    lv_obj_delete(img);
    lv_display_delete(disp);
}

// A nearly opaque image is drawn through a layer of strips as wide as the screen (466x26, never the
// display's height), blended by the same hook into the layer's buffer. Their corners must reach the frame.
// This does not isolate the destination-buffer guard (the direct-call case and the canvas case do).
ZTEST(gauge_draw_sw, test_a_layered_full_width_image_keeps_its_corners) {
    views_test::EnsureTestDisplay();
    constexpr uint16_t RED = 0xF800;
    for(auto& px : image_pixels) {
        px = RED;
    }
    lv_display_t* disp = CreatePanel();

    lv_image_dsc_t image{};
    image.header.magic = LV_IMAGE_HEADER_MAGIC;
    image.header.cf = LV_COLOR_FORMAT_RGB565;
    image.header.w = PANEL;
    image.header.h = PANEL;
    image.header.stride = PANEL * 2;
    image.data_size = sizeof(image_pixels);
    image.data = AsBytes(image_pixels);

    lv_obj_t* screen = lv_display_get_screen_active(disp);
    lv_obj_set_style_bg_color(screen, lv_color_hex(0x0000FF), 0);
    lv_obj_set_style_bg_opa(screen, LV_OPA_COVER, 0);
    lv_obj_t* img = lv_image_create(screen);
    lv_image_set_src(img, &image);
    lv_obj_set_pos(img, 0, 0);
    lv_obj_set_style_opa_layered(img, LV_OPA_COVER - 1, 0);

    FillFrame(disp, SENTINEL);
    lv_refr_now(disp);

    const lv_draw_buf_t* buf = disp->buf_act;
    const Rows rows{ buf->data, static_cast<int32_t>(buf->header.stride) };
    for(const int32_t x : { 0, 2, 233, 463, 465 }) {
        for(const int32_t y : { 0, 2, 233, 463, 465 }) {
            // Red with a trace of the blue background behind it: R5 31 or 30, no green, B5 at most 1.
            const uint16_t px = Swap16(rows.At(x, y));
            zassert_true(
                (px >> 11) >= 30 && ((px >> 5) & 0x3F) == 0 && (px & 0x1F) <= 1, "pixel %d,%d is 0x%04x", (int)x,
                (int)y, (unsigned)px
            );
        }
    }

    lv_obj_delete(img);
    lv_display_delete(disp);
}

// A canvas of the display's size in the display's format is drawn while the display is refreshing (as a
// snapshot is): it is not the active buffer, so every pixel of it is copied, corners included.
ZTEST(gauge_draw_sw, test_a_display_sized_canvas_is_copied_whole_while_the_display_refreshes) {
    views_test::EnsureTestDisplay();
    FillSource();
    lv_display_t* disp = CreatePanel();

    lv_draw_buf_t canvas_buf;
    lv_draw_buf_init(&canvas_buf, PANEL, PANEL, LV_COLOR_FORMAT_RGB565_SWAPPED, 0, other_store, sizeof(other_store));
    lv_draw_buf_clear(&canvas_buf, nullptr);
    FillBytes(other_store, sizeof(other_store));
    zassert_not_equal(static_cast<const void*>(canvas_buf.data), static_cast<const void*>(disp->buf_act->data));

    lv_image_dsc_t image{};
    image.header.magic = LV_IMAGE_HEADER_MAGIC;
    image.header.cf = LV_COLOR_FORMAT_RGB565;
    image.header.w = PANEL;
    image.header.h = PANEL;
    image.header.stride = PANEL * 2;
    image.data_size = sizeof(image_pixels);
    image.data = AsBytes(image_pixels);

    lv_obj_t* canvas = lv_canvas_create(lv_display_get_screen_active(disp));
    lv_canvas_set_draw_buf(canvas, &canvas_buf);
    lv_layer_t layer;
    lv_canvas_init_layer(canvas, &layer);
    lv_draw_image_dsc_t dsc;
    lv_draw_image_dsc_init(&dsc);
    dsc.src = &image;
    const lv_area_t area = { 0, 0, PANEL - 1, PANEL - 1 };
    lv_refr_set_disp_refreshing(disp);
    lv_draw_image(&layer, &dsc, &area);
    lv_canvas_finish_layer(canvas, &layer);
    lv_refr_set_disp_refreshing(nullptr);

    CheckFrame({ canvas_buf.data, static_cast<int32_t>(canvas_buf.header.stride) }, SwappedSource, false, PANEL);

    lv_obj_delete(canvas);
    lv_display_delete(disp);
}

    #endif // CONFIG_GAUGE_ROUND_PANEL_CLIP

ZTEST_SUITE(gauge_draw_sw, nullptr, nullptr, nullptr, views_test::CleanTestDisplay, nullptr);

#endif // CONFIG_LV_DRAW_SW_ASM_CUSTOM
```

## src/image_cover.cpp
```c
// LVGL patch lvgl_image_opaque_alpha.patch: an lv_image with a variable RGB565A8 source whose alpha bytes
// are all 0xFF covers what lies beneath it and draws through its RGB565 view; every other image does not cover.
#include <cstdint>
#include <memory>
#include <vector>

#include <zephyr/ztest.h>

#include <lvgl.h>
extern "C" {
#include <core/lv_obj_event_private.h> // lv_cover_check_info_t
}

#include "domain/ui_domain/lvgl_lock.h"
#include "views_test_support.h"

namespace {

constexpr int32_t IMAGE_SIZE = 8;
constexpr int32_t IMAGE_X = 4;
constexpr int32_t IMAGE_Y = 4;
constexpr uint16_t RED_565 = 0xF800;
constexpr uint16_t GREEN_565 = 0x07E0;

constexpr bool HAS_RGB565A8 = LV_COLOR_FORMAT_NATIVE_WITH_ALPHA == LV_COLOR_FORMAT_RGB565A8;

// An RGB565A8 image: the left half red, the right half green; the alpha of the pixels is chosen per column.
class TestImage {
public:
    explicit TestImage(uint8_t left_alpha = 0xFF, uint8_t right_alpha = 0xFF) {
        const uint32_t stride = IMAGE_SIZE * 2;
        data_.resize((stride + stride / 2) * IMAGE_SIZE);
        for(int32_t y = 0; y < IMAGE_SIZE; ++y) {
            for(int32_t x = 0; x < IMAGE_SIZE; ++x) {
                const uint16_t color = x < IMAGE_SIZE / 2 ? RED_565 : GREEN_565;
                data_[stride * y + x * 2] = color & 0xFF;
                data_[stride * y + x * 2 + 1] = color >> 8;
                data_[stride * IMAGE_SIZE + (stride / 2) * y + x] = x < IMAGE_SIZE / 2 ? left_alpha : right_alpha;
            }
        }
        dsc_.header.magic = LV_IMAGE_HEADER_MAGIC;
        dsc_.header.cf = LV_COLOR_FORMAT_RGB565A8;
        dsc_.header.w = IMAGE_SIZE;
        dsc_.header.h = IMAGE_SIZE;
        dsc_.header.stride = stride;
        dsc_.data_size = data_.size();
        dsc_.data = data_.data();
    }

    // One alpha byte below 0xFF in an otherwise opaque image.
    void LowerOneAlpha() {
        data_[(IMAGE_SIZE * 2) * IMAGE_SIZE + 3] = 0xFE;
    }

    const lv_image_dsc_t* Dsc() const {
        return &dsc_;
    }

private:
    std::vector<uint8_t> data_;
    lv_image_dsc_t dsc_{};
};

struct Scene {
    lv_obj_t* parent;
    lv_obj_t* image;
};

// A 40x40 parent with an opaque blue background and the image at (IMAGE_X, IMAGE_Y), transparent background.
Scene MakeScene(const lv_image_dsc_t* source) {
    lv_obj_t* parent = lv_obj_create(lv_screen_active());
    lv_obj_remove_style_all(parent);
    lv_obj_set_size(parent, 40, 40);
    lv_obj_set_style_bg_color(parent, lv_color_hex(0x0000FF), 0);
    lv_obj_set_style_bg_opa(parent, LV_OPA_COVER, 0);
    lv_obj_t* image = lv_image_create(parent);
    lv_image_set_src(image, source);
    lv_obj_set_pos(image, IMAGE_X, IMAGE_Y);
    lv_obj_update_layout(parent);
    zassert_equal(lv_obj_get_width(image), IMAGE_SIZE);
    zassert_equal(lv_obj_get_height(image), IMAGE_SIZE);
    return { parent, image };
}

lv_cover_res_t CoverCheck(lv_obj_t* image, const lv_area_t& area) {
    lv_cover_check_info_t info{ .res = LV_COVER_RES_COVER, .area = &area };
    lv_obj_send_event(image, LV_EVENT_COVER_CHECK, &info);
    return info.res;
}

// An area strictly inside the image.
lv_cover_res_t CoverCheckInside(lv_obj_t* image) {
    lv_area_t area;
    lv_obj_get_coords(image, &area);
    lv_area_set(&area, area.x1 + 1, area.y1 + 1, area.x2 - 1, area.y2 - 1);
    return CoverCheck(image, area);
}

struct Pixel {
    uint8_t red, green, blue;
};

Pixel PixelAt(lv_obj_t* parent, int32_t x, int32_t y) {
    lv_obj_update_layout(parent);
    std::unique_ptr<lv_draw_buf_t, decltype(&lv_draw_buf_destroy)> snapshot(
        lv_snapshot_take(parent, LV_COLOR_FORMAT_ARGB8888), lv_draw_buf_destroy
    );
    zassert_not_null(snapshot);
    const auto& pixel = views_test::PixelRow(*snapshot, y)[x];
    return { pixel.red, pixel.green, pixel.blue };
}

void CheckPixel(lv_obj_t* parent, int32_t x, int32_t y, Pixel expected) {
    const auto actual = PixelAt(parent, x, y);
    zassert_true(
        actual.red == expected.red && actual.green == expected.green && actual.blue == expected.blue,
        "pixel %d,%d = %u,%u,%u, expected %u,%u,%u", x, y, actual.red, actual.green, actual.blue, expected.red,
        expected.green, expected.blue
    );
}

void* Setup() {
    views_test::EnsureTestDisplay();
    return nullptr;
}

} // namespace

ZTEST_SUITE(image_cover, NULL, Setup, NULL, views_test::CleanTestDisplay, NULL);

ZTEST(image_cover, test_opaque_image_covers_area_inside) {
    if(!HAS_RGB565A8)
        ztest_test_skip();
    eerie_leap::domain::ui_domain::ScopedLvglLock lock;
    TestImage opaque;
    const auto scene = MakeScene(opaque.Dsc());
    zassert_equal(CoverCheckInside(scene.image), LV_COVER_RES_COVER);
}

ZTEST(image_cover, test_image_with_a_transparent_byte_does_not_cover_and_resets_on_new_source) {
    if(!HAS_RGB565A8)
        ztest_test_skip();
    eerie_leap::domain::ui_domain::ScopedLvglLock lock;
    TestImage opaque;
    TestImage holed;
    holed.LowerOneAlpha();
    const auto scene = MakeScene(opaque.Dsc());
    zassert_equal(CoverCheckInside(scene.image), LV_COVER_RES_COVER);
    // The cached alpha state of the first source must not outlive it.
    lv_image_set_src(scene.image, holed.Dsc());
    zassert_equal(CoverCheckInside(scene.image), LV_COVER_RES_NOT_COVER);
    lv_image_set_src(scene.image, opaque.Dsc());
    zassert_equal(CoverCheckInside(scene.image), LV_COVER_RES_COVER);
}

ZTEST(image_cover, test_colorkey_image_does_not_cover) {
    if(!HAS_RGB565A8)
        ztest_test_skip();
    eerie_leap::domain::ui_domain::ScopedLvglLock lock;
    static const lv_image_colorkey_t KEY{ .low = lv_color_hex(0x000000), .high = lv_color_hex(0x000000) };
    TestImage opaque;
    const auto scene = MakeScene(opaque.Dsc());
    lv_obj_set_style_image_colorkey(scene.image, &KEY, 0);
    zassert_not_equal(CoverCheckInside(scene.image), LV_COVER_RES_COVER);
}

ZTEST(image_cover, test_translucent_image_does_not_cover) {
    if(!HAS_RGB565A8)
        ztest_test_skip();
    eerie_leap::domain::ui_domain::ScopedLvglLock lock;
    TestImage opaque;
    const auto scene = MakeScene(opaque.Dsc());
    lv_obj_set_style_image_opa(scene.image, 200, 0);
    zassert_not_equal(CoverCheckInside(scene.image), LV_COVER_RES_COVER);
}

ZTEST(image_cover, test_rotated_image_does_not_cover) {
    if(!HAS_RGB565A8)
        ztest_test_skip();
    eerie_leap::domain::ui_domain::ScopedLvglLock lock;
    TestImage opaque;
    const auto scene = MakeScene(opaque.Dsc());
    lv_image_set_rotation(scene.image, 300);
    zassert_not_equal(CoverCheckInside(scene.image), LV_COVER_RES_COVER);
}

ZTEST(image_cover, test_scaled_image_does_not_cover) {
    if(!HAS_RGB565A8)
        ztest_test_skip();
    eerie_leap::domain::ui_domain::ScopedLvglLock lock;
    TestImage opaque;
    const auto scene = MakeScene(opaque.Dsc());
    lv_image_set_scale(scene.image, 512);
    zassert_not_equal(CoverCheckInside(scene.image), LV_COVER_RES_COVER);
}

ZTEST(image_cover, test_area_larger_than_image_is_not_covered) {
    if(!HAS_RGB565A8)
        ztest_test_skip();
    eerie_leap::domain::ui_domain::ScopedLvglLock lock;
    TestImage opaque;
    const auto scene = MakeScene(opaque.Dsc());
    lv_area_t area;
    lv_obj_get_coords(scene.image, &area);
    lv_area_set(&area, area.x1 - 2, area.y1 - 2, area.x2 + 2, area.y2 + 2);
    zassert_not_equal(CoverCheck(scene.image, area), LV_COVER_RES_COVER);
}

ZTEST(image_cover, test_opaque_image_draws_its_own_colors) {
    if(!HAS_RGB565A8)
        ztest_test_skip();
    eerie_leap::domain::ui_domain::ScopedLvglLock lock;
    TestImage opaque;
    const auto scene = MakeScene(opaque.Dsc());
    CheckPixel(scene.parent, IMAGE_X + 1, IMAGE_Y + 4, { 255, 0, 0 });
    CheckPixel(scene.parent, IMAGE_X + 6, IMAGE_Y + 4, { 0, 255, 0 });
    CheckPixel(scene.parent, 1, 1, { 0, 0, 255 }); // Outside the image: the parent.
}

ZTEST(image_cover, test_transparent_pixels_show_the_parent) {
    if(!HAS_RGB565A8)
        ztest_test_skip();
    eerie_leap::domain::ui_domain::ScopedLvglLock lock;
    TestImage holed(0x00, 0xFF);
    const auto scene = MakeScene(holed.Dsc());
    CheckPixel(scene.parent, IMAGE_X + 1, IMAGE_Y + 4, { 0, 0, 255 }); // Alpha 0: the blue parent.
    CheckPixel(scene.parent, IMAGE_X + 6, IMAGE_Y + 4, { 0, 255, 0 });
}
```
