## Kconfig
```kconfig
# Project configuration options

rsource "drivers/Kconfig"

config GAUGE_ROUND_PANEL_CLIP
	bool "Skip the corners of full-screen image copies on a round panel"
	depends on LV_DRAW_SW_ASM_CUSTOM
	default n
	help
	  A round panel shows only the circle inscribed in its frame buffer, so the corners of a full-screen
	  image copy are never seen. With this option the gauge's blend hook copies, for a blit that fills the
	  display's whole active frame buffer, only the chord of that circle (plus a margin) in each row. The panel
	  still receives the full rectangle; the corners keep whatever pixels were there before, which nobody sees.
	  Layers of the same size (transform layers, snapshots) are always copied whole.

config GAUGE_ROUND_PANEL_CLIP_MARGIN_PX
	int "Pixels kept on each side of a row beyond the chord"
	depends on GAUGE_ROUND_PANEL_CLIP
	range 0 16
	default 2
	help
	  Pixels copied on each side of a row beyond the inscribed circle's chord.
```

## boards/waveshare/esp32s3_touch_amoled_1_75/Kconfig.esp32s3_touch_amoled_1_75
```kconfig
# Copyright (c) 2024 Joel Guittet
# SPDX-License-Identifier: Apache-2.0

config BOARD_ESP32S3_TOUCH_AMOLED_1_75
	select SOC_ESP32S3
	select SOC_ESP32S3_PROCPU if BOARD_ESP32S3_TOUCH_AMOLED_1_75_ESP32S3_PROCPU
	select SOC_ESP32S3_APPCPU if BOARD_ESP32S3_TOUCH_AMOLED_1_75_ESP32S3_APPCPU

# Display configuration
config DISPLAY
	bool "Display support"
	default y if BOARD_ESP32S3_TOUCH_AMOLED_1_75
```

## drivers/Kconfig
```kconfig
menu "Drivers"
rsource "mspi/Kconfig.esp32"
rsource "display/Kconfig.elco5300"
rsource "display/Kconfig.waveshare_hx8394"
rsource "input/Kconfig.cst92xx"
endmenu
```

## drivers/display/Kconfig.elco5300
```kconfig
# Copyright 2025 Pavel Maloletkov.
# SPDX-License-Identifier: Apache-2.0

# CO5300 QSPI Display Controller Configuration

config ELCO5300
	bool "CO5300 QSPI Display Controller"
	default y
	depends on DT_HAS_CHIPONE_ELCO5300_ENABLED
	help
	  Enable support for the CO5300 QSPI display controller.

config ELCO5300_TE_SYNC
	bool "Start frames on the panel's tearing-effect edge"
	depends on ELCO5300
	help
	  Enable the TE output (mode 1) and let a write that starts a frame
	  wait for the edge that begins a panel scan (the te-gpios property is
	  required). The write then stays behind the scan, so full-frame
	  updates do not tear. When a frame takes longer than one scan the
	  next frame waits for the following edge and the frame rate drops to
	  60/n FPS. The wait is skipped while the display is blanked, for
	  later areas of the same frame, and after repeated TE timeouts.

config ELCO5300_TE_WINDOW
	bool "Start every area inside its tear-free window"
	depends on ELCO5300_TE_SYNC
	help
	  Instead of waiting for the falling TE edge before a frame, start each
	  area (first, later and re-sent ones) at a phase of the panel's scan at
	  which the scan can neither overtake the write nor be overtaken by it
	  inside the area's rows. A full frame then starts up to several
	  milliseconds after an edge and stays on screen for one scan more
	  often than with the edge rule. Needs the scan period and the TE low
	  time measured (a few scans after start), a fresh edge and the normal
	  orientation; otherwise the edge rule is used. The window comes from
	  pure functions in co5300_te_window.h.

config ELCO5300_TE_WINDOW_MARGIN_US
	int "Margin around the forbidden start interval (microseconds)"
	default 500
	depends on ELCO5300_TE_WINDOW
	help
	  Added on both sides of an area's forbidden start interval, for the
	  start latency, the position of the first row against the edge and
	  the write time's tail beyond its recent maximum. It cannot cover a
	  long stall inside a write (a cooperative thread running for
	  milliseconds between two DMA pieces), which can tear the area; the
	  bench audit counts such a write as late. A stale edge falls back to
	  the edge rule.

config ELCO5300_STATS
	bool "CO5300 bench counters"
	depends on ELCO5300
	depends on SHELL
	help
	  Bench counters read by the app's ui_bench shell command; adds a few
	  cycles per transaction.
```

## drivers/display/Kconfig.hx8394_lcd5
```kconfig
# Copyright (c) 2026 Hongquan Li
# SPDX-License-Identifier: Apache-2.0

config HX8394_LCD5
	bool "Waveshare HX8394 MIPI DSI panel"
	default y
	depends on DT_HAS_WAVESHARE_HX8394_ENABLED
	depends on MIPI_DSI
	help
	  Enable support for the HX8394 driving the Waveshare 5" 720x1280
	  MIPI DSI module.
```

## drivers/display/Kconfig.waveshare_hx8394
```kconfig
# Copyright (c) 2026 Hongquan Li
# SPDX-License-Identifier: Apache-2.0

config WAVESHARE_HX8394
	bool "Waveshare HX8394 MIPI DSI panel"
	default y
	depends on DT_HAS_WAVESHARE_HX8394_ENABLED
	depends on MIPI_DSI
	select PWM
	help
	  Enable support for the HX8394 driving the Waveshare 5" 720x1280
	  MIPI DSI module. PWM is what the panel is dimmed from, the
	  controller having no brightness command of its own.
```

## drivers/mspi/Kconfig.esp32
```kconfig
# Copyright 2026 Pavel Maloletkov
# SPDX-License-Identifier: Apache-2.0

config MSPI_ESP32
	bool "ESP32 MSPI driver"
	depends on DT_HAS_ESPRESSIF_ESP32_MSPI_ENABLED
	help
	  Enable ESP32 MSPI driver. This driver provides support for the
	  ESP32 SPI peripherals through the Zephyr MSPI interface.

if MSPI_ESP32

config MSPI_DMA_MAX_BUFFER_SIZE
	int "MSPI DMA bounce buffer size (Byte)"
	default 4092
	help
	  Size of the driver's bounce buffer, and nothing else. Data the DMA
	  can reach (4-byte aligned internal RAM) is sent straight from the
	  caller's buffer, in hardware transactions of up to 32,768 bytes
	  (2^18 bits, or what the GDMA descriptor table holds if smaller). Data
	  it cannot reach, such as PSRAM, is copied through the bounce buffer
	  and sent in pieces of this many bytes (at most one hardware
	  transaction). A packet longer than one transaction is split by the
	  driver with CE held, and the command and address go out with the
	  first piece only; callers need not chunk. Transfers of at most 64
	  bytes go through the SPI data registers and never use the buffer.

config MSPI_ESP32_INTERRUPT
	bool "ESP32 MSPI interrupt mode"
	default y
	help
	  Signal transfer completion using the SPI "transaction done"
	  interrupt instead of busy-polling the hardware from the calling
	  thread. This lets other threads run while a transfer is in
	  flight, instead of spinning the calling thread's CPU for the full
	  duration of every transfer. Requires an "interrupts" property on
	  the MSPI controller's devicetree node.

config MSPI_ESP32_PSRAM_DMA
	bool "Transfer directly out of PSRAM buffers"
	depends on ESP_SPIRAM
	help
	  Hand a PSRAM buffer to be sent straight to the DMA instead of copying
	  it into internal RAM first. The buffer must start on a data cache line
	  (the larger of CONFIG_DCACHE_LINE_SIZE and the SoC's cache line, 32 B
	  by default on the S3) and on a word; its length is free. Such a packet
	  goes out in transactions of up to 32 KB with CE held, and the TX channel
	  reads PSRAM in blocks of up to 64 B (the largest block the buffer's
	  alignment allows; 64 B-aligned buffers are the fast case, see
	  CONFIG_LV_Z_VDB_ALIGN). Buffers that do not qualify, and every receive
	  buffer, still use the bounce buffer.

	  This removes the copy, but the DMA must then feed the transmit FIFO
	  straight from PSRAM at the full bus rate. PSRAM bandwidth is shared
	  with instruction fetch and any other external-RAM traffic, so when it
	  cannot keep up the FIFO underruns and the SPI would send stale bytes.
	  The driver checks the SPI's out-FIFO-empty error after every such
	  transaction and fails the transfer with -EIO when it is set (the frame
	  is corrupt and has to be drawn again); with CONFIG_MSPI_ESP32_STATS
	  the counters psram_transactions and psram_underruns show how often.

	  Only enable this if the bus clock is low enough that PSRAM can sustain
	  it, and check psram_underruns on the bench.

config MSPI_ESP32_STATS
	bool "ESP32 MSPI bench counters"
	depends on SHELL
	help
	  Bench counters read by the app's ui_bench shell command; adds a few
	  cycles per transaction.

endif # MSPI_ESP32
```

## dts/bindings/display/chipone,elco5300.yaml
```yaml
# Copyright (c) 2024 OSPTEK Co., Ltd.
# SPDX-License-Identifier: Apache-2.0

description: CO5300 QSPI Display Controller

compatible: "chipone,elco5300"

include: [mspi-device.yaml, display-controller.yaml, lcd-controller.yaml, pinctrl-device.yaml]

properties:
  te-gpios:
    type: phandle-array
    description: |
      Tearing effect GPIO pin.

  reset-gpios:
    type: phandle-array
    description: |
      Reset GPIO pin. Set high to reset the display

  orientation:
    type: string
    default: "normal"
    enum:
      - "normal"
      - "90"
      - "180"
      - "270"
    description: Display orientation (CW) in degrees. Only "normal" and "180" are supported by the driver. At 180 the x-offset and y-offset are applied unchanged; a panel mirrored over 480 columns (466 wide) may need another x-offset there (unverified).

  x-offset:
    type: int
    default: 0
    description: The column offset in pixels of the display

  y-offset:
    type: int
    default: 0
    description: The row offset in pixels of the display
```

## dts/bindings/display/waveshare,hx8394.yaml
```yaml
#
# Copyright (c) 2026 Hongquan Li
#
# SPDX-License-Identifier: Apache-2.0
#

description: |
  Himax HX8394 driving the Waveshare 5" 720x1280 MIPI DSI module.

  Same controller as himax,hx8394, but the power, VCOM, GIP and gamma
  registers are properties of the glass rather than of the controller, so this
  panel carries the bring-up sequence published by Waveshare for it.

compatible: "waveshare,hx8394"

include: [mipi-dsi-device.yaml, display-controller.yaml]

properties:
  reset-gpios:
    type: phandle-array
    description: |
      Panel reset line. This panel resets on a high level, so the pin is
      described as active high.

  pwms:
    type: phandle-array
    description: |
      Backlight output driving the module's LED driver. The controller has no
      brightness command of its own, so display_set_brightness() is this duty
      cycle. Without it the panel stays dark however the sequence above went.
```

## tests/functional/domain/ui_domain/Kconfig
```kconfig
menu "Zephyr"
source "Kconfig.zephyr"
endmenu

config EERIE_LEAP_HW_VERSION_MAJOR
	int "Hardware version major"
	range 0 255
	default 0

config EERIE_LEAP_HW_VERSION_MINOR
	int "Hardware version minor"
	range 0 255
	default 0

config EERIE_LEAP_HW_VERSION_PATCH
	int "Hardware version patch"
	range 0 65535
	default 0

config EERIE_LEAP_SW_VERSION_MAJOR
	int "Software version major"
	range 0 255
	default 0

config EERIE_LEAP_SW_VERSION_MINOR
	int "Software version minor"
	range 0 255
	default 0

config EERIE_LEAP_SW_VERSION_PATCH
	int "Software version patch"
	range 0 65535
	default 0

config EERIE_LEAP_UI_RENDERER_THREAD_STACK_SIZE
	int "UI renderer thread stack size"
	default 8192

config EERIE_LEAP_UI_ROTATION
	int
	default 0

config EERIE_LEAP_FS_SD_THREAD_STACK_SIZE
	int "SD thread stack size"
	default 2048

config EERIE_LEAP_SD_CHECK_INTERVAL_MS
	int "SD check interval ms"
	default 1000
```

## tests/unit/te_window/testcase.yaml
```yaml
common:
  tags:
    - unit
    - te_window
  platform_allow:
    - native_sim

tests:
  unit.te_window: {}
```

## west.yml
```yaml
# Copyright (c) 2021 Nordic Semiconductor ASA
# SPDX-License-Identifier: Apache-2.0

manifest:
  self:
    west-commands: scripts/west-commands.yml

  remotes:
    - name: zephyrproject-rtos
      url-base: https://github.com/zephyrproject-rtos

  projects:
    - name: zephyr
      remote: zephyrproject-rtos
      revision: main
      import:
        # By using name-allowlist we can clone only the modules that are
        # strictly needed by the application.
        name-allowlist:
          - cmsis           # required by the ARM port
          - mcuboot         # bootloader
          - esp32           # required by the esp32 board
          - hal_espressif   # required by the esp32 board
          - zcbor           # CBOR light JSON like data format
          - fatfs           # FATFS filesystem
          - littlefs        # littleFS lightweight filesystem
          - mbedtls         # BLE/WiFi
          - tf-psa-crypto   # BLE/WiFi
          - nanopb          # esp-hosted-mcu transport (ESP32-C6 BLE/WiFi)
          - picolibc        # picolibc
          - lvgl            # LVGL
```
